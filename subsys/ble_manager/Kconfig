## subsys/ble_manager/Kconfig
```kconfig
#
# Copyright (c) 2026 Nordic Semiconductor ASA
#
# SPDX-License-Identifier: LicenseRef-Nordic-5-Clause
#

menuconfig DOOR_LOCK_BLE_MANAGER
	bool "Door Lock BLE manager"
	depends on BT

if DOOR_LOCK_BLE_MANAGER

module = DOOR_LOCK_BLE_MANAGER
module-str = Door Lock BLE manager
source "$(ZEPHYR_BASE)/subsys/logging/Kconfig.template.log_config"

config DOOR_LOCK_BLE_MANAGER_INIT
	bool "Initialize Bluetooth stack"
	depends on !CHIP
	help
	  When enabled, a random static LE address is created for the default identity
	  and the Bluetooth stack is enabled.

config DOOR_LOCK_BLE_MANAGER_AUTH
	bool "Enable authentication"
	help
	  When enabled, registers pairing, passkey, and security-level
	  callbacks for the default Bluetooth identity (BT_ID_DEFAULT).

	  The application can enable this option or register its own authentication callbacks.
	  Only one authentication callback can be registered in the Bluetooth stack.

if DOOR_LOCK_BLE_MANAGER_AUTH

config DOOR_LOCK_BLE_MANAGER_AUTH_APP_PASSKEY_SUPPORT
	bool "Enable application-provided pairing passkey"
	select BT_APP_PASSKEY
	help
	  When enabled, the application can provide a passkey for pairing.

if DOOR_LOCK_BLE_MANAGER_AUTH_APP_PASSKEY_SUPPORT

config DOOR_LOCK_BLE_MANAGER_AUTH_APP_PASSKEY
	int "Application-provided pairing passkey"
	default 123456
	range 0 999999
	help
	  Passkey returned from the authentication callback.

endif # DOOR_LOCK_BLE_MANAGER_AUTH_APP_PASSKEY_SUPPORT

endif # DOOR_LOCK_BLE_MANAGER_AUTH

endif # DOOR_LOCK_BLE_MANAGER
```

## subsys/dfu_smp_service/Kconfig
```kconfig
#
# Copyright (c) 2026 Nordic Semiconductor ASA
#
# SPDX-License-Identifier: LicenseRef-Nordic-5-Clause
#

menuconfig DOOR_LOCK_DFU_SMP_SERVICE
	bool "Door Lock DFU SMP service"
	depends on BOOTLOADER_MCUBOOT
	select DOOR_LOCK_ADVERTISING_ARBITER if !CHIP
	help
	  Enables the Device Firmware Upgrade Service over Bluetooth LE Simple Management Protocol.

if DOOR_LOCK_DFU_SMP_SERVICE

module = DOOR_LOCK_DFU_SMP_SERVICE
module-str = Door Lock DFU SMP service
module-dep = LOG
source "$(ZEPHYR_BASE)/subsys/logging/Kconfig.template.log_config"

config DOOR_LOCK_DFU_SMP_SERVICE_SHELL
	bool "Shell commands for DFU SMP service"
	depends on SHELL
	default y
	help
	  Enable shell commands to start and stop the DFU BLE SMP service.

endif # DOOR_LOCK_DFU_SMP_SERVICE
```

## subsys/external_nvs/Kconfig
```kconfig
#
# Copyright (c) 2026 Nordic Semiconductor ASA
#
# SPDX-License-Identifier: LicenseRef-Nordic-5-Clause
#

menuconfig DOOR_LOCK_EXTERNAL_NVS
	bool "External NVS Storage"
	select NVS
	select FLASH
	select FLASH_MAP
	select PSA_WANT_GENERATE_RANDOM
	select PSA_WANT_KEY_TYPE_CHACHA20
	select PSA_WANT_ALG_CHACHA20_POLY1305
	select HW_UNIQUE_KEY
	select HW_UNIQUE_KEY_RANDOM
	select HW_UNIQUE_KEY_WRITE_ON_CRYPTO_INIT
	depends on !SOC_SERIES_NRF52X
	help
	  Enable External NVS Storage.

if DOOR_LOCK_EXTERNAL_NVS

module = DOOR_LOCK_EXTERNAL_NVS
module-str = Door Lock External NVS Storage
source "$(ZEPHYR_BASE)/subsys/logging/Kconfig.template.log_config"

config  DOOR_LOCK_EXTERNAL_NVS_MAX_DATA_SIZE
	int "Maximum data size"
	range 1 65535
	default 1024
	help
	  Maximum data size for the external NVS storage objects.

config DOOR_LOCK_EXTERNAL_NVS_ROLLBACK_PROTECTION
	bool "Enable rollback protection"
	depends on SETTINGS
	default y
	help
	  Enable rollback protection for the external NVS storage.

if DOOR_LOCK_EXTERNAL_NVS_ROLLBACK_PROTECTION

config DOOR_LOCK_EXTERNAL_NVS_ROLLBACK_PROTECTION_SETTINGS_PREFIX
	string "Settings prefix"
	default "ext"
	help
		Prefix for the settings keys for the rollback protection.

config DOOR_LOCK_EXTERNAL_NVS_ROLLBACK_PROTECTION_UNIQUE_ID_SIZE
	int "Unique ID size"
	default 8
	help
		Size of the unique ID for the rollback protection.

endif # DOOR_LOCK_EXTERNAL_NVS_ROLLBACK_PROTECTION

endif # DOOR_LOCK_EXTERNAL_NVS
```

## subsys/matter_access/Kconfig
```kconfig
#
# Copyright (c) 2026 Nordic Semiconductor ASA
#
# SPDX-License-Identifier: LicenseRef-Nordic-5-Clause
#

menuconfig DOOR_LOCK_MATTER_ACCESS
	bool "Matter Access Storage"
	depends on CHIP
	help
	  Enable Matter Access Storage.

if DOOR_LOCK_MATTER_ACCESS

module = DOOR_LOCK_MATTER_ACCESS
module-str = Door Lock Matter Access Storage
source "$(ZEPHYR_BASE)/subsys/logging/Kconfig.template.log_config"

config DOOR_LOCK_MATTER_ACCESS_MAX_NUM_USERS
	int "Maximum number of users supported by the lock"
	default 10

config DOOR_LOCK_MATTER_ACCESS_MAX_NUM_CREDENTIALS_PER_USER
	int "Maximum total number of credentials per one user supported by the lock"
	default 4

config DOOR_LOCK_MATTER_ACCESS_MAX_NUM_CREDENTIALS_PER_TYPE
	int "Maximum number of credentials of given type supported by the lock"
	default 15

config DOOR_LOCK_MATTER_ACCESS_MAX_CREDENTIAL_LENGTH
	int "Maximum length of the single credential supported by the lock"
	default 10

config DOOR_LOCK_MATTER_ACCESS_CREDENTIAL_TYPES_PIN
	bool "Support for PIN credentials"

config DOOR_LOCK_MATTER_ACCESS_CREDENTIAL_TYPES_RFID
	bool "Support for RFID credentials"

config DOOR_LOCK_MATTER_ACCESS_CREDENTIAL_TYPES_FINGER
	bool "Support for Fingerprint credentials"

config DOOR_LOCK_MATTER_ACCESS_CREDENTIAL_TYPES_VEIN
	bool "Support for FingerVein credentials"

config DOOR_LOCK_MATTER_ACCESS_CREDENTIAL_TYPES_FACE
	bool "Support for Face credentials"

config DOOR_LOCK_MATTER_ACCESS_CREDENTIAL_TYPES_ALIRO
	bool "Support for Aliro credentials"

config DOOR_LOCK_MATTER_ACCESS_SCHEDULES
	bool "Support for WeekDay, YearDay and Holiday schedules in lock"
	help
	  This option adds support for an optional Timed Schedule Access Lock feature.
	  You can use Week Day, Year Day and Holiday schedules to restrict access for a
	  specific user for a defined time window. For example, use it to
	  give the user access only for three days in week.

if DOOR_LOCK_MATTER_ACCESS_SCHEDULES

config DOOR_LOCK_MATTER_ACCESS_SCHEDULES_MAX_WEEKDAY_SCHEDULES_PER_USER
	int "Maximum number of WeekDay schedules per one user supported by the lock"
	default 5

config DOOR_LOCK_MATTER_ACCESS_SCHEDULES_MAX_YEARDAY_SCHEDULES_PER_USER
	int "Maximum number of YearDay schedules per one user supported by the lock"
	default 5

config DOOR_LOCK_MATTER_ACCESS_SCHEDULES_MAX_HOLIDAY_SCHEDULES
	int "Maximum number of Holiday schedules supported by the lock"
	default 5

endif # DOOR_LOCK_MATTER_ACCESS_SCHEDULES

config DOOR_LOCK_MATTER_ACCESS_DEBUG
	bool "Debug features to print users and credentials"
	help
	  Debug features allow for checking and printing current users, their state, and
	  associated credentials.

config DOOR_LOCK_MATTER_ACCESS_PRINT_STORAGE_STATUS
	bool "Print storage status after each store call"
	# This feature assumes that items are eventually stored in Zephyr settings subsystem
	depends on TRUSTED_STORAGE_STORAGE_BACKEND_SETTINGS
	help
	  Debug feature to print the debug-level log that contains information of the entry being stored
	  to persistent storage and how many bytes are left to store the new entry. It can be used to verify
	  whether credential, schedule or user entries are written properly to persistent storage.
	  This option should be disabled in production firmware
	  version.

choice DOOR_LOCK_MATTER_ACCESS_STORAGE_CHOICE
	prompt "Access storage implementation"
	default DOOR_LOCK_MATTER_ACCESS_STORAGE_PROTECTED_STORAGE

config DOOR_LOCK_MATTER_ACCESS_STORAGE_PROTECTED_STORAGE
	bool "PSA Protected Storage"
	# PSA SSF Crypto Client is not ready for PSA PS backend
	depends on !CHIP_WIFI && !PSA_SSF_CRYPTO_CLIENT
	# When building with TF-M, Protected Storage is enabled by default
	select TRUSTED_STORAGE if !BUILD_WITH_TFM
	select PSA_PROTECTED_STORAGE if !BUILD_WITH_TFM

endchoice

if DOOR_LOCK_MATTER_ACCESS_STORAGE_PROTECTED_STORAGE

config DOOR_LOCK_MATTER_ACCESS_STORAGE_PROTECTED_STORAGE_UID_OFFSET
	int "Access storage PSA Protected Storage UID range start"
	default 0

endif # DOOR_LOCK_MATTER_ACCESS_STORAGE_PROTECTED_STORAGE

endif # DOOR_LOCK_MATTER_ACCESS
```

## subsys/nfc_prop/Kconfig
```kconfig
#
# Copyright (c) 2026 Nordic Semiconductor ASA
#
# SPDX-License-Identifier: LicenseRef-Nordic-5-Clause
#

config DOOR_LOCK_NFC_PROP
	bool "Enable support for proprietary NFC Technology"
	depends on NFC_DRIVER_STM
	help
	  Enable proprietary NFC technology module using RFAL PROP API.
	  This optional module implements custom NFC functionality that
	  enhances device detection capabilities.
```

## subsys/nus_service/Kconfig
```kconfig
#
# Copyright (c) 2026 Nordic Semiconductor ASA
#
# SPDX-License-Identifier: LicenseRef-Nordic-5-Clause
#

menuconfig DOOR_LOCK_NUS_SERVICE
	bool "Door Lock NUS service"
	select BT_NUS
	select BT_NUS_AUTHEN
	select BT_SMP
	imply DOOR_LOCK_BLE_MANAGER_AUTH
	select DOOR_LOCK_ADVERTISING_ARBITER if !CHIP
	help
	  Enables the Bluetooth LE Nordic UART Service (NUS). Using NUS service you can control
	  a door lock using pre-defined BLE commands.

if DOOR_LOCK_NUS_SERVICE

module = DOOR_LOCK_NUS_SERVICE
module-str = Door Lock NUS service
module-dep = LOG
source "$(ZEPHYR_BASE)/subsys/logging/Kconfig.template.log_config"

config DOOR_LOCK_NUS_SERVICE_MAX_COMMANDS
	int "Maximum number of NUS commands"
	default 2
	help
	  Define the maximum number of NUS commands to declare by user.

config DOOR_LOCK_NUS_SERVICE_MAX_COMMAND_LEN
	int "Maximum length of single command in Bytes"
	default 10
	help
	  Maximum length of single command. This command will be sent via Bluetooth LE to
	  a paired smart door lock.

endif # DOOR_LOCK_NUS_SERVICE
```

## subsys/settings_utils/Kconfig
```kconfig
#
# Copyright (c) 2026 Nordic Semiconductor ASA
#
# SPDX-License-Identifier: LicenseRef-Nordic-5-Clause
#

menuconfig DOOR_LOCK_SETTINGS_UTILS
	bool "Settings Utils"
	depends on SETTINGS

if DOOR_LOCK_SETTINGS_UTILS

module = DOOR_LOCK_SETTINGS_UTILS
module-str = Door Lock Settings Utils
source "$(ZEPHYR_BASE)/subsys/logging/Kconfig.template.log_config"

endif # DOOR_LOCK_SETTINGS_UTILS
```

## tests/functional/subsys/aliro/crypto_utils/testcase.yaml
```yaml
tests:
  door_lock.functional.subsys.aliro.crypto_utils:
    sysbuild: true
    platform_allow: &platforms
      - nrf52840dk/nrf52840
      - nrf5340dk/nrf5340/cpuapp
      - nrf54l15dk/nrf54l15/cpuapp
      - nrf54lm20dk/nrf54lm20a/cpuapp
    integration_platforms: *platforms
    tags: Aliro Crypto Utils
```

## tests/functional/subsys/external_nvs/testcase.yaml
```yaml
tests:
  door_lock.functional.subsys.external_nvs:
    sysbuild: true
    platform_allow: &platforms
      - nrf5340dk/nrf5340/cpuapp
      - nrf54l15dk/nrf54l15/cpuapp
      - nrf54lm20dk/nrf54lm20b/cpuapp
    integration_platforms: *platforms
```

## tests/subsys/external_nvs/testcase.yaml
```yaml
tests:
  aliro.subsys.external_nvs:
    sysbuild: true
    platform_allow: &platforms
      - nrf5340dk/nrf5340/cpuapp
      - nrf54l15dk/nrf54l15/cpuapp
      - nrf54lm20dk/nrf54lm20a/cpuapp
    integration_platforms: *platforms
```

## tests/subsys/settings_utils/Kconfig
```kconfig
#
# Copyright (c) 2026 Nordic Semiconductor ASA
#
# SPDX-License-Identifier: LicenseRef-Nordic-5-Clause
#

config NVS
	default y if !SOC_FLASH_NRF_RRAM

config NVS_LOOKUP_CACHE_SIZE
	default 512 if NVS

config NVS_LOOKUP_CACHE_FOR_SETTINGS
	default y if SETTINGS_NVS

config ZMS
	default y if SOC_FLASH_NRF_RRAM

config ZMS_LOOKUP_CACHE_SIZE
	default 512 if SETTINGS_ZMS

config ZMS_LOOKUP_CACHE_FOR_SETTINGS
	default y if SETTINGS_ZMS

choice NVS_LOG_LEVEL_CHOICE
	default NVS_LOG_LEVEL_DBG
endchoice

choice ZMS_LOG_LEVEL_CHOICE
	default ZMS_LOG_LEVEL_DBG
endchoice

choice SETTINGS_LOG_LEVEL_CHOICE
	default SETTINGS_LOG_LEVEL_DBG
endchoice

source "Kconfig.zephyr"
```
