## drivers/nfc/stm/Kconfig.rfal
```kconfig
#
# Copyright (c) 2025 Nordic Semiconductor ASA
#
# SPDX-License-Identifier: LicenseRef-Nordic-5-Clause
#

config RFAL_FEATURE_LISTEN_MODE
    bool "Enable Listen Mode"
    help
        Enable or disable RFAL support for Listen Mode.

config RFAL_FEATURE_WAKEUP_MODE
    bool "Enable Wake-Up Mode"
    help
        Enable or disable RFAL support for the Wake-Up mode.

config RFAL_FEATURE_LOWPOWER_MODE
    bool "Enable Low Power Mode"
    help
        Enable or disable RFAL support for the Low Power mode.

config RFAL_FEATURE_NFCA
    bool "Enable NFC-A (ISO14443A)"
    help
        Enable or disable RFAL support for NFC-A (ISO14443A).

config RFAL_FEATURE_NFCB
    bool "Enable NFC-B (ISO14443B)"
    help
        Enable or disable RFAL support for NFC-B (ISO14443B).

config RFAL_FEATURE_NFCF
    bool "Enable NFC-F (FeliCa)"
    help
        Enable or disable RFAL support for NFC-F (FeliCa).

config RFAL_FEATURE_NFCV
    bool "Enable NFC-V (ISO15693)"
    help
        Enable or disable RFAL support for NFC-V (ISO15693).

config RFAL_FEATURE_T1T
    bool "Enable T1T (Topaz)"
    help
        Enable or disable RFAL support for T1T (Topaz).

config RFAL_FEATURE_T2T
    bool "Enable T2T"
    help
        Enable or disable RFAL support for T2T.

config RFAL_FEATURE_T4T
    bool "Enable T4T"
    help
        Enable or disable RFAL support for T4T.

config RFAL_FEATURE_ST25TB
    bool "Enable ST25TB"
    help
        Enable or disable RFAL support for ST25TB.

config RFAL_FEATURE_ST25xV
    bool "Enable ST25TV/ST25DV"
    depends on RFAL_FEATURE_NFCV
    help
        Enable or disable RFAL support for ST25TV/ST25DV.

config RFAL_FEATURE_DYNAMIC_ANALOG_CONFIG
    bool "Enable Dynamic Analog Configuration"
    help
        Enable or disable dynamic updates of analog configuration

config RFAL_FEATURE_DPO
    bool "Enable Dynamic Power Output"
    help
        Enable or disable RFAL Dynamic Power Output support.

config RFAL_FEATURE_ISO_DEP
    bool "Enable ISO-DEP (ISO14443-4)"
    help
        Enable or disable RFAL support for ISO-DEP (ISO14443-4).

config RFAL_FEATURE_ISO_DEP_POLL
    bool "Enable ISO-DEP Poller mode (PCD)"
    depends on RFAL_FEATURE_ISO_DEP
    default y   # there must be select at least one mode: Poller and/or listener
    help
        Enable or disable RFAL support for Poller mode (PCD) ISO-DEP (ISO14443-4).

config RFAL_FEATURE_ISO_DEP_LISTEN
    bool "Enable ISO-DEP Listen mode (PICC)"
    depends on RFAL_FEATURE_ISO_DEP
    help
        Enable or disable RFAL support for Listen mode (PICC) ISO-DEP (ISO14443-4).

config RFAL_FEATURE_ISO_DEP_IBLOCK_MAX_LEN
    int "ISO-DEP I-Block max length"
    depends on RFAL_FEATURE_ISO_DEP
    range 16 4096
    default 256
    help
        Set the ISO-DEP I-Block max length. Use values as defined by rfalIsoDepFSx.

config RFAL_FEATURE_NFC_DEP
    bool "Enable NFC-DEP (NFCIP1/P2P)"
    help
        Enable or disable RFAL support for NFC-DEP (NFCIP1/P2P).

choice RFAL_FEATURE_NFC_DEP_BLOCK_MAX_LEN_CHOICE
    bool "NFC-DEP Block/Payload length"
    depends on RFAL_FEATURE_NFC_DEP
    default RFAL_FEATURE_NFC_DEP_BLOCK_MAX_LEN_254

config RFAL_FEATURE_NFC_DEP_BLOCK_MAX_LEN_254
    bool "NFC-DEP Block/Payload length equal to 254 bytes"

config RFAL_FEATURE_NFC_DEP_BLOCK_MAX_LEN_192
    bool "NFC-DEP Block/Payload length equal to 192 bytes"

config RFAL_FEATURE_NFC_DEP_BLOCK_MAX_LEN_128
    bool "NFC-DEP Block/Payload length equal to 128 bytes"

config RFAL_FEATURE_NFC_DEP_BLOCK_MAX_LEN_64
    bool "NFC-DEP Block/Payload length equal to 64 bytes"

endchoice

config RFAL_FEATURE_NFC_DEP_BLOCK_MAX_LEN
    int
    default 254 if RFAL_FEATURE_NFC_DEP_BLOCK_MAX_LEN_254
    default 192 if RFAL_FEATURE_NFC_DEP_BLOCK_MAX_LEN_192
    default 128 if RFAL_FEATURE_NFC_DEP_BLOCK_MAX_LEN_128
    default 64 if RFAL_FEATURE_NFC_DEP_BLOCK_MAX_LEN_64

config RFAL_FEATURE_NFC_RF_BUF_LEN
    int "RF buffer length used by RFAL NFC layer"
	default 258
    help
        Set the RF buffer length used by RFAL NFC layer.

config RFAL_FEATURE_ISO_DEP_APDU_MAX_LEN
    int "ISO-DEP APDU max length"
    depends on RFAL_FEATURE_ISO_DEP
    range RFAL_FEATURE_ISO_DEP_IBLOCK_MAX_LEN 8192
    default 512
    help
        Set the ISO-DEP APDU max length. Please use multiples of I-Block max length.

config RFAL_FEATURE_NFC_DEP_PDU_MAX_LEN
    int "NFC-DEP PDU max length"
    depends on RFAL_FEATURE_NFC_DEP
    range 0 RFAL_FEATURE_NFC_DEP_BLOCK_MAX_LEN
    default 512
    help
        Set the NFC-DEP PDU max length. This is the maximum length of Protocol Data Unit that can be exchanged.
```

## drivers/nfc/stm/Kconfig.shield
```kconfig
#
# Copyright (c) 2025 Nordic Semiconductor ASA
#
# SPDX-License-Identifier: LicenseRef-Nordic-5-Clause
#

config X_NUCLEO_NFC05A1
	def_bool $(shields_list_contains, x_nucleo_nfc05a1)

config SPI
	default y
```

## drivers/nfc/stm/nfc_configs/Kconfig
```kconfig
#
# Copyright (c) 2025 Nordic Semiconductor ASA
#
# SPDX-License-Identifier: LicenseRef-Nordic-5-Clause
#

choice RFAL_WAKE_UP_MODE
	prompt "Wake-Up Mode configuration"
	default RFAL_WAKE_UP_MODE_RELAXED
	depends on RFAL_FEATURE_WAKEUP_MODE

config RFAL_WAKE_UP_MODE_STRICT
	bool "Strict configuration - less sensitive, more robust"

config RFAL_WAKE_UP_MODE_RELAXED
	bool "Relaxed configuration - more sensitive, less robust"

config RFAL_WAKE_UP_MODE_DEFAULT
	bool "Default RFAL WUM configuration - balanced sensitivity and robustness"

endchoice # RFAL_WAKE_UP_MODE

# Additional wake-up polling behavior
config RFAL_WAKEUP_POLL_BEFORE
    bool "Poll before entering Wake-Up mode"
    depends on RFAL_FEATURE_WAKEUP_MODE
    default y
    help
      Enable polling before entering Wake-Up mode for better device detection.

config RFAL_WAKEUP_NPOLLS
    int "Number of polling cycles before/after Wake-Up mode"
    depends on RFAL_FEATURE_WAKEUP_MODE
    range 1 100
    default 10
    help
      Number of polling cycles to perform before and after Wake-Up mode.
```

## dts/bindings/access-decision-indicator.yaml
```yaml
#
# Copyright (c) 2025 Nordic Semiconductor ASA
#
# SPDX-License-Identifier: LicenseRef-Nordic-5-Clause
#

description: |
  This binding allows to assign a GPIO to indicate access granted decision.

compatible: "access-decision-indicator"

properties:
  gpios:
    type: phandle-array
    required: true
```

## dts/bindings/nfc-power-control.yaml
```yaml
#
# Copyright (c) 2025 Nordic Semiconductor ASA
#
# SPDX-License-Identifier: LicenseRef-Nordic-4-Clause
#

description: GPIO pin to switch a NFC tag on or off

compatible: "nfc-power-control"

include: base.yaml

properties:
  gpios:
    type: phandle-array
    required: true
    description: |
      The GPIO connected to the gate driver for the MOSFET on the PCA64176.
```

## dts/bindings/uwb/nxp,uwb-device.yaml
```yaml
# Copyright (c) 2026 Nordic Semiconductor ASA
# SPDX-License-Identifier: LicenseRef-Nordic-5-Clause

description: NXP UWB device used by the NXP SR250 Zephyr port

compatible: "nxp,uwb-device"

include: spi-device.yaml

properties:
  uwb,irq-gpios:
    type: phandle-array
    required: true
    description: Interrupt GPIO connected to the UWB module IRQ/INT pin.

  uwb,rstn-gpios:
    type: phandle-array
    required: true
    description: Active-high reset-not GPIO connected to the UWB module reset pin.

  uwb,cs-gpios:
    type: phandle-array
    required: true
    description: Active-low chip-select GPIO connected to the UWB module CS pin.
```

## dts/bindings/uwb/truesense,tsrr250.yaml
```yaml
# Copyright (c) 2026 Nordic Semiconductor ASA
# SPDX-License-Identifier: LicenseRef-Nordic-5-Clause

description: TrueSense TSRR250 UWB module based on NXP Trimension SR250

compatible: "truesense,tsrr250"

include: spi-device.yaml

properties:
  reset-gpios:
    type: phandle-array
    required: true
    description: Active-low reset GPIO connected to TSRR250 RST.

  irq-gpios:
    type: phandle-array
    required: true
    description: Interrupt GPIO connected to TSRR250 INT.
```

## dts/bindings/x-nucleo-nfc.yaml
```yaml
#
# Copyright (c) 2025 Nordic Semiconductor ASA
#
# SPDX-License-Identifier: LicenseRef-Nordic-4-Clause
#

description: |
    STMicroelectronics ST25R NFC readers

compatible: "x-nucleo-nfc"

include: spi-device.yaml

properties:
  irq-gpios:
    type: phandle-array
    required: true

  reset-gpios:
    type: phandle-array
    required: false

  led-nfca-gpios:
    type: phandle-array
    required: false

  led-nfcb-gpios:
    type: phandle-array
    required: false

  led-nfcf-gpios:
    type: phandle-array
    required: false
```

## lib/Kconfig
```kconfig
#
# Copyright (c) 2025 Nordic Semiconductor ASA
#
# SPDX-License-Identifier: LicenseRef-Nordic-5-Clause
#

orsource "aliro/Kconfig"
rsource "qm35_uwb/Kconfig"
```

## lib/aliro/Kconfig
```kconfig
#
# Copyright (c) 2026 Nordic Semiconductor ASA
#
# SPDX-License-Identifier: LicenseRef-Nordic-4-Clause
#

menuconfig NCS_ALIRO
	bool "NCS Aliro Stack"
	depends on (SOC_SERIES_NRF54L || SOC_SERIES_NRF53 || SOC_SERIES_NRF52)
	select NFC_T4T_APDU
	select SMF
	select SMF_ANCESTOR_SUPPORT
	select SMF_INITIAL_TRANSITION
	select ZCBOR
	select ZCBOR_CANONICAL
	help
	  This option enables the Aliro reader stack.
	  The Aliro stack provides the core functionality for Aliro readers.

if NCS_ALIRO

config NCS_ALIRO_RELEASE
	bool "Enable Aliro release configuration"
	help
	  This option selects precompiled Aliro stack libraries without logs.

choice NCS_ALIRO_LOG_LEVEL
    prompt "Log level for Aliro module"
    default NCS_ALIRO_LOG_LEVEL_OFF if NCS_ALIRO_RELEASE
    default NCS_ALIRO_LOG_LEVEL_DBG

config NCS_ALIRO_LOG_LEVEL_OFF
    bool "Aliro module log level set to off"
    help
      No logging

config NCS_ALIRO_LOG_LEVEL_ERR
    bool "Aliro module log level set to error"
    help
      Error logging only

config NCS_ALIRO_LOG_LEVEL_WRN
    bool "Aliro module log level set to warning"
    help
      Warning and error logging

config NCS_ALIRO_LOG_LEVEL_INF
    bool "Aliro module log level set to info"
    help
      Informational, warning and error logging

config NCS_ALIRO_LOG_LEVEL_DBG
    bool "Aliro module log level set to debug"
    help
      Debug, informational, warning and error logging

endchoice

config NCS_ALIRO_LOG_LEVEL_VALUE
    int
    default 0 if NCS_ALIRO_LOG_LEVEL_OFF
    default 1 if NCS_ALIRO_LOG_LEVEL_ERR
    default 2 if NCS_ALIRO_LOG_LEVEL_WRN
    default 3 if NCS_ALIRO_LOG_LEVEL_INF
    default 4 if NCS_ALIRO_LOG_LEVEL_DBG

config NCS_ALIRO_BLE_UWB
	bool "Aliro Bluetooth LE (BLE) transport together with ultra wideband (UWB)"
	depends on (SOC_NRF54LM20A || SOC_NRF54LM20B || SOC_SERIES_NRF53)
	help
	  Enable the Aliro BLE transport protocol (TP). This is the transport layer
	  used by the Reader to communicate with the User Device. It is used to send and
	  receive packets over BLE. Additionally the UWB is enabled in order to manage the
	  ranging between the Reader and the User Device.

endif # NCS_ALIRO
```

## lib/aliro/Kconfig.aliro
```kconfig
#
# Copyright (c) 2026 Nordic Semiconductor ASA
#
# SPDX-License-Identifier: LicenseRef-Nordic-4-Clause
#

menuconfig NCS_ALIRO
	bool "NCS Aliro Stack [EXPERIMENTAL]"
	select EXPERIMENTAL
	help
	  This option enables the Aliro reader stack.
	  The Aliro stack provides the core functionality for Aliro readers.

if NCS_ALIRO

config NCS_ALIRO_BLE_UWB
	bool "Aliro Bluetooth LE (BLE) transport together with ultra wideband (UWB)"
	help
	  Enable the Aliro BLE transport protocol (TP). This is the transport layer
	  used by the Reader to communicate with the User Device. It is used to send and
	  receive packets over BLE. Additionally the UWB is enabled in order to manage the
	  ranging between the Reader and the User Device.

endif # NCS_ALIRO
```

## lib/aliro/Kconfig.aliro.defconfig
```kconfig
#
# Copyright (c) 2025 Nordic Semiconductor ASA
#
# SPDX-License-Identifier: LicenseRef-Nordic-5-Clause
#

# crypto default configuration
config ENTROPY_PSA_CRYPTO_RNG
	default y

config MBEDTLS_PSA_CRYPTO_C
	default y

config MBEDTLS_ENABLE_HEAP
	default y

config MBEDTLS_HEAP_SIZE
	default 8192

config PSA_WANT_ALG_ECDSA
	default y

config PSA_WANT_ALG_ECDH
	default y

config PSA_WANT_KEY_TYPE_ECC_KEY_PAIR_GENERATE
	default y

config PSA_WANT_KEY_TYPE_ECC_KEY_PAIR_IMPORT
	default y

config PSA_WANT_KEY_TYPE_ECC_KEY_PAIR_EXPORT
	default y

config PSA_WANT_ECC_SECP_R1_256
	default y

config PSA_WANT_ALG_SHA_256
	default y

config PSA_WANT_ALG_HKDF
	default y

config PSA_WANT_ALG_HMAC
	default y

config PSA_WANT_KEY_TYPE_HMAC
	default y

config PSA_WANT_KEY_TYPE_AES
	default y

config PSA_WANT_ALG_ECB_NO_PADDING
	default y

config PSA_WANT_GENERATE_RANDOM
	default y

config PSA_WANT_ALG_GCM
	default y

# APDU library
config NFC_T4T_APDU
	default y

# required by Aliro persistent storage 
config FLASH
	default y

config FLASH_MAP
	default y

config NVS
	default y

config SETTINGS
	default y

# required by Aliro CLI 
config REBOOT
	default y

config SHELL
	default y

config BT_DEVICE_NAME
	default "AliroDL"

config BT
	default y

config BT_PERIPHERAL
	default y

config BT_SMP
	default y

config BT_USER_PHY_UPDATE
	default y

config BT_BUF_ACL_RX_SIZE
	default 251

config BT_BUF_ACL_TX_SIZE
	default 251

config BT_L2CAP_TX_MTU
	default 247

config BT_GATT_DYNAMIC_DB
	default y

config BT_GATT_ENFORCE_SUBSCRIPTION
	default y

config BT_GATT_SERVICE_CHANGED
	default y

config BT_L2CAP_DYNAMIC_CHANNEL
	default y

config EVENTS
	default y

config SMF
	default y

config SMF_ANCESTOR_SUPPORT
	default y

config SMF_INITIAL_TRANSITION
	default y

config NRF_SECURITY
	default y

config BT_CTLR_TX_PWR_DYNAMIC_CONTROL
	default y if !SOC_NRF5340_CPUAPP
```
