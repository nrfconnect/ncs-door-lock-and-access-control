## app/src/platform/uwb_impl/uwb_qm35_impl/Kconfig
```kconfig
#
# Copyright (c) 2025 Nordic Semiconductor ASA
#
# SPDX-License-Identifier: LicenseRef-Nordic-5-Clause
#

config ALIRO_UWB_MIN_RAN_MULTIPLIER
	int "Minimum RAN multiplier for UWB ranging blocks"
	default 1
	range 1 255
	help
	  The RAN multiplier allows to define the time between 2 ranging blocks.
	  The time range is between 96 ms (RAN multiplier is 1) and 24480 ms
	  (RAN multiplier is 255).

### Hopping bitmasks based on the Table 19-31, CCC spec. 1.2.3 (Hopping_Config_Bitmask)
choice ALIRO_UWB_HOPPING_MODE
	prompt "Preferred hopping configuration"
	default ALIRO_UWB_HOPPING_MODE_CONTINUOUS
	help
	  Select the preferred hopping configuration for UWB.

config ALIRO_UWB_HOPPING_MODE_ADAPTIVE
	bool "Adaptive hopping mode"

config ALIRO_UWB_HOPPING_MODE_CONTINUOUS
	bool "Continuous hopping mode"

config ALIRO_UWB_HOPPING_MODE_NONE
	bool "No hopping"

endchoice

config ALIRO_UWB_HOPPING_MODE_VALUE
	hex
	default 0x20 if ALIRO_UWB_HOPPING_MODE_ADAPTIVE
	default 0x40 if ALIRO_UWB_HOPPING_MODE_CONTINUOUS
	default 0x80 if ALIRO_UWB_HOPPING_MODE_NONE

if !ALIRO_UWB_HOPPING_MODE_NONE

config ALIRO_UWB_HOPPING_SEQUENCE_AES
	bool "AES based hopping sequence"

config ALIRO_UWB_HOPPING_SEQUENCE_AES_VALUE
	hex
	default 0x08 if ALIRO_UWB_HOPPING_SEQUENCE_AES
	default 0x00

config ALIRO_UWB_HOPPING_SEQUENCE_DEFAULT_VALUE
	hex
	default 0x10

endif

###

config ALIRO_UWB_MAC_MODE_OFFSET
	int "Offset between ranging blocks in MAC mode"
	default 0
	range 0 63
	help
	  Offset between the 2 ranging blocks.

config ALIRO_UWB_MAC_MODE_RANGING_ROUNDS
	int "Number of ranging rounds per ranging block"
	default 0
	range 0 1
	help
	  Number of ranging rounds used in a ranging block.
	  Values:
	  - 0: 1 ranging round
	  - 1: 2 ranging round

config ALIRO_UWB_SESSION_LOGGING
	bool "Enable UWB session state logging"
	help
	  Enable logging for UWB session states and reason codes.

config ALIRO_UWB_RANGING_SESSION_INIT_DELAY_MS
	int "Delay before automatic UWB ranging session initiation (milliseconds) by the Reader"
	default 100
	range 10 5000
	help
	  Specifies the time a Reader Device waits before it initiates the ranging session by its own.
```

## app/src/platform/uwb_impl/uwb_qm35_impl/Kconfig.defconfig
```kconfig
#
# Copyright (c) 2025 Nordic Semiconductor ASA
#
# SPDX-License-Identifier: LicenseRef-Nordic-5-Clause
#

config UART_NRFX_UARTE_LEGACY_SHIM
	bool
	default n

config Q_ALIRO_UWB_ADAPTER
	bool
	default y
```

## app/src/storage/Kconfig
```kconfig
#
# Copyright (c) 2025 Nordic Semiconductor ASA
#
# SPDX-License-Identifier: LicenseRef-Nordic-5-Clause
#

module = NCS_DOOR_LOCK_APP_STORAGE
module-str = NCS_DOOR_LOCK_APP_STORAGE
module-dep = LOG
module-help = Enables nRF Connect SDK Door Lock Application storage log messages.
source "${ZEPHYR_BASE}/subsys/logging/Kconfig.template.log_config"
```

## app/sysbuild/ipc_radio/boards/nrf5340dk_nrf5340_cpunet.conf
```kconfig
#
# Copyright (c) 2025 Nordic Semiconductor ASA
#
# SPDX-License-Identifier: LicenseRef-Nordic-5-Clause
#

# Enable dynamic power control for the BT controller (on net core)
CONFIG_BT_CTLR_TX_PWR_DYNAMIC_CONTROL=y

# Disable central role to allow connection with multiple central devices
CONFIG_BT_CENTRAL=n
```

## applications/aliro-access-control-app/src/aliro/Kconfig
```kconfig
#
# Copyright (c) 2025 Nordic Semiconductor ASA
#
# SPDX-License-Identifier: LicenseRef-Nordic-5-Clause
#

menu "Aliro features"

config DOOR_LOCK_BLE_UWB
	bool "Integration with Aliro BLE and UWB [EXPERIMENTAL]"
	select NCS_ALIRO_BLE_UWB
	select DOOR_LOCK_ALIRO_UWB
	select DOOR_LOCK_ALIRO_BLE_SERVICE
	select DOOR_LOCK_ALIRO_READER_STORAGE_GROUP_RESOLVING_KEY_SUPPORT
	select DOOR_LOCK_ALIRO_READER_STORAGE_SHELL_GROUP
	select EXPERIMENTAL
	help
	  Enable the door lock application integration with Aliro Bluetooth LE (BLE) and ultra wideband (UWB).

if DOOR_LOCK_BLE_UWB

config DOOR_LOCK_BLE_UWB_MAX_SESSIONS
	int "Maximum number of BLE and UWB sessions"
	range 1 BT_MAX_CONN
	help
	  The maximum number of BLE and UWB sessions that can be established.

endif # DOOR_LOCK_BLE_UWB

config DOOR_LOCK_EXPEDITED_FAST_PHASE
    bool "Support for Aliro Expedited-fast Phase"
    help
        If enabled, the Expedited-fast phase is supported.
        The user authentication is based on the Kpersistent keys.

config DOOR_LOCK_STEP_UP_PHASE
    bool "Support for Aliro Step-up Phase"
    select DOOR_LOCK_ALIRO_ACCESS_DOCUMENT_PARSER
    select DOOR_LOCK_EXTERNAL_NVS if !SOC_SERIES_NRF52
    help
        If enabled, the Step-up phase is supported.
        The user authentication is based on the Access Document.

config DOOR_LOCK_CREDENTIAL_ISSUER_CA
    bool "Support for Credential Issuer CA public key"
    default y if DOOR_LOCK_STEP_UP_PHASE
    depends on DOOR_LOCK_STEP_UP_PHASE
    help
        If enabled, the Credential Issuer CA public key is supported.
        The Credential Issuer CA public key is used to verify the signature of the Credential Issuer certificate.

config DOOR_LOCK_READER_CERTIFICATE
	bool "Support for Reader certificates"
	default y
	select DOOR_LOCK_ALIRO_READER_STORAGE_CERTIFICATE_SUPPORT
	select DOOR_LOCK_ALIRO_READER_STORAGE_SHELL_CERT
	help
	  Use the reader certificate for the reader authentication.

endmenu # Aliro features

rsource "platform/Kconfig"
rsource "access_manager/Kconfig"
rsource "kpersistent_manager/Kconfig"
rsource "storage/Kconfig"
```

## applications/aliro-access-control-app/src/aliro/interface_impl/Kconfig
```kconfig
#
# Copyright (c) 2026 Nordic Semiconductor ASA
#
# SPDX-License-Identifier: LicenseRef-Nordic-5-Clause
#

menu "Aliro interface implementation"

config DOOR_LOCK_INTERFACE_IMPL_CRYPTO_PSA_AEAD_SINGLE_PART
    bool
    default y if SOC_NRF54LM20A || SOC_NRF54LM20B
    help
      When enabled, the single-part AEAD API is used.

if DOOR_LOCK_INTERFACE_IMPL_CRYPTO_PSA_AEAD_SINGLE_PART

config DOOR_LOCK_INTERFACE_IMPL_CRYPTO_PSA_AEAD_SINGLE_PART_BUFFER_SIZE
    int "Maximum size of the buffer used for the single-part AEAD API"
    default 256
    help
      Maximum size of the buffer used for the single-part AEAD API.

endif # DOOR_LOCK_INTERFACE_IMPL_CRYPTO_PSA_AEAD_SINGLE_PART

endmenu # Aliro interface implementation
```

## applications/aliro-access-control-app/src/dfu_smp/Kconfig
```kconfig
#
# Copyright (c) 2025 Nordic Semiconductor ASA
#
# SPDX-License-Identifier: LicenseRef-Nordic-5-Clause
#

menuconfig DOOR_LOCK_DFU_BLE_SMP
    bool "DFU over SMP"
    select DOOR_LOCK_ADVERTISING_ARBITER
    help
      Enables Device Firmware Upgrade over Bluetooth LE.

if DOOR_LOCK_DFU_BLE_SMP

module = DFU_SMP
module-str = DFU_SMP
module-dep = LOG
module-help = Enables DFU SMP module log messages.
source "$(ZEPHYR_BASE)/subsys/logging/Kconfig.template.log_config"

endif # DOOR_LOCK_DFU_BLE_SMP
```

## applications/matter-aliro-door-lock-app/src/aliro/Kconfig
```kconfig
#
# Copyright (c) 2025 Nordic Semiconductor ASA
#
# SPDX-License-Identifier: LicenseRef-Nordic-5-Clause
#

menu "Aliro features"

config DOOR_LOCK_BLE_UWB
	bool "Integration with Aliro BLE and UWB"
	select NCS_ALIRO_BLE_UWB
	select DOOR_LOCK_ALIRO_UWB
	select DOOR_LOCK_ALIRO_BLE_SERVICE
	select DOOR_LOCK_ALIRO_READER_STORAGE_GROUP_RESOLVING_KEY_SUPPORT
	help
	  Enable the door lock application integration with Aliro Bluetooth LE (BLE) and ultra wideband (UWB).

if DOOR_LOCK_BLE_UWB

config DOOR_LOCK_BLE_UWB_MAX_SESSIONS
	int "Maximum number of BLE and UWB sessions"
	range 1 BT_MAX_CONN
	help
	  The maximum number of BLE and UWB sessions that can be established.

endif # DOOR_LOCK_BLE_UWB

config DOOR_LOCK_EXPEDITED_FAST_PHASE
    bool "Support for Aliro Expedited-fast Phase"
    default y
    help
        If enabled, the Expedited-fast phase is supported.
        The user authentication is based on the Kpersistent keys.

config DOOR_LOCK_STEP_UP_PHASE
    bool "Support for Aliro Step-up Phase"
    default y
    select DOOR_LOCK_ALIRO_ACCESS_DOCUMENT_PARSER
    select DOOR_LOCK_EXTERNAL_NVS if !SOC_SERIES_NRF52
    help
        If enabled, the Step-up phase is supported.
        The user authentication is based on the Access Document.

config DOOR_LOCK_CREDENTIAL_ISSUER_CA
    bool "Support for Credential Issuer CA public key"
    depends on DOOR_LOCK_STEP_UP_PHASE
    help
        If enabled, the Credential Issuer CA public key is supported.
        The Credential Issuer CA public key is used to verify the signature of the Credential Issuer certificate.

config DOOR_LOCK_READER_CERTIFICATE
	bool "Support for Reader certificates"
	select DOOR_LOCK_ALIRO_READER_STORAGE_CERTIFICATE_SUPPORT
	select DOOR_LOCK_ALIRO_READER_STORAGE_SHELL_CERT
	help
	  Use the reader certificate for the reader authentication.

config DOOR_LOCK_TIME_CONCEPT
	bool "Support for Time concept"
	default y
	select DOOR_LOCK_ALIRO_TIME_UTILS
	help
	  If enabled, the Time concept is supported.

endmenu # Aliro features

rsource "platform/Kconfig"
rsource "access_manager/Kconfig"
rsource "cli/Kconfig"
rsource "kpersistent_manager/Kconfig"
rsource "storage/Kconfig"
```

## applications/matter-aliro-door-lock-app/src/aliro/access_manager/Kconfig
```kconfig
#
# Copyright (c) 2025 Nordic Semiconductor ASA
#
# SPDX-License-Identifier: LicenseRef-Nordic-5-Clause
#

menu "Access Manager"

config DOOR_LOCK_ACCESS_MANAGER_CREDENTIAL_ISSUER_MAX_STORED_KEYS
    int "Maximum number of stored Credential Issuer public keys"
    default 5 if DOOR_LOCK_STEP_UP_PHASE
    default 0
    help
      Specifies the maximum number of Credential Issuer public keys that can be
      stored in the AccessManager. This determines the size of
      the statically allocated array for key storage. The Credential Issuer
      public key is used to verify the signature of the access document.
      If this option is set to 0, the access document is not supported.

config DOOR_LOCK_ACCESS_MANAGER_ACCESS_CREDENTIAL_MAX_STORED_KEYS
    int "Maximum number of stored public keys"
    default 35
    help
      Specifies the maximum number of public keys that can be
      stored in the AccessManager. This determines the size of
      the statically allocated array for key storage.

if DOOR_LOCK_BLE_UWB

config DOOR_LOCK_ACCESS_MANAGER_MAX_ALLOWED_DISTANCE_CM
    int "Maximum allowed distance for granting access (cm)"
    default 150
    help
      Specifies the maximum allowed distance provided by
      UWB ranging to grant an access (in centimeters).
      This is used to determine if the Aliro User Device
      is within the allowed proximity range.

config DOOR_LOCK_ACCESS_MANAGER_MAX_ALLOWED_DISTANCE_EXIT_MARGIN_CM
    int "Exit margin above max allowed distance for locking (cm)"
    default 30
    help
      Specifies an additional margin (in centimeters) added to
      DOOR_LOCK_ACCESS_MANAGER_MAX_ALLOWED_DISTANCE_CM that is used to determine
      when the door should be locked (exit range). This margin prevents rapid
      open/close toggling when the measured distance fluctuates around the
      maximum allowed distance threshold.

      Behavior:
      - Unlock (enter range): distance <= MAX_ALLOWED_DISTANCE_CM
      - Lock (exit range): distance > MAX_ALLOWED_DISTANCE_CM + EXIT_MARGIN_CM

      The exit margin is applied per UWB ranging session based on the session's
      previous state. When a session transitions from "out of range" to "in range",
      the unlock threshold is MAX_ALLOWED_DISTANCE_CM. Once unlocked, the session
      must exceed MAX_ALLOWED_DISTANCE_CM + EXIT_MARGIN_CM to trigger locking.

      Set to 0 to disable the exit margin (door will lock immediately when
      distance exceeds MAX_ALLOWED_DISTANCE_CM).

choice DOOR_LOCK_ACCESS_MANAGER_TERMINATE_SESSION
    prompt "Terminate session on given condition"
    default DOOR_LOCK_ACCESS_MANAGER_TERMINATE_SESSION_DISABLED
    help
      Select the condition under which the AccessManager will
      terminate the current Aliro session.

config DOOR_LOCK_ACCESS_MANAGER_TERMINATE_SESSION_DISABLED
    bool "Never terminate session automatically"
    help
      If enabled, the AccessManager will never automatically terminate
      UWB ranging sessions. Sessions will only be terminated when explicitly
      requested by the User Device or when the BLE connection is lost.
      This option is useful when you want the User Device to have full
      control over session lifecycle.

config DOOR_LOCK_ACCESS_MANAGER_TERMINATE_SESSION_ON_ACCESS_GRANTED
    bool "Terminate the session if the access was granted"
    help
      If enabled, the AccessManager will terminate each
      session immediately when an access is granted.

config DOOR_LOCK_ACCESS_MANAGER_TERMINATE_SESSION_ON_TIMEOUT
    bool "Terminate session on timeout"
    help
      If enabled, the AccessManager will terminate each ongoing
      session if it times out according to DOOR_LOCK_ACCESS_MANAGER_SESSION_TIMEOUT_MS.

endchoice

if DOOR_LOCK_ACCESS_MANAGER_TERMINATE_SESSION_ON_TIMEOUT

config DOOR_LOCK_ACCESS_MANAGER_SESSION_TIMEOUT_MS
    int "Session timeout in milliseconds"
    default 10000

endif

endif # DOOR_LOCK_BLE_UWB

endmenu # Access Manager
```

## applications/matter-aliro-door-lock-app/src/aliro/cli/Kconfig
```kconfig
#
# Copyright (c) 2025 Nordic Semiconductor ASA
#
# SPDX-License-Identifier: LicenseRef-Nordic-5-Clause
#

if DOOR_LOCK_CLI

config DOOR_LOCK_CLI_PROVISIONING
	bool
	default y if DOOR_LOCK_CREDENTIAL_ISSUER_CA

config SHELL_CMD_BUFF_SIZE
	# Shell buffer must fit: "reader certificate set " (23 chars) + hex string (2 * cert size)
	# For 512 byte cert: 23 + 1024 = 1047
	default 1047 if (SHELL && DOOR_LOCK_ALIRO_READER_STORAGE_SHELL_CERT)

endif # DOOR_LOCK_CLI
```

## applications/matter-aliro-door-lock-app/src/aliro/platform/crypto/Kconfig
```kconfig
#
# Copyright (c) 2026 Nordic Semiconductor ASA
#
# SPDX-License-Identifier: LicenseRef-Nordic-5-Clause
#

rsource "Kconfig.defaults"

menu "Crypto"

config DOOR_LOCK_CRYPTO_PSA_AEAD_SINGLE_PART
    bool
    default y if SOC_NRF54LM20A || SOC_NRF54LM20B
    help
      When enabled, the single-part AEAD API is used.

if DOOR_LOCK_CRYPTO_PSA_AEAD_SINGLE_PART

config DOOR_LOCK_CRYPTO_PSA_AEAD_SINGLE_PART_BUFFER_SIZE
    int "Maximum size of the buffer used for the single-part AEAD API"
    default 256
    help
      Maximum size of the buffer used for the single-part AEAD API.

endif # DOOR_LOCK_CRYPTO_PSA_AEAD_SINGLE_PART

endmenu # Crypto
```

## drivers/nfc/stm/Kconfig
```kconfig
#
# Copyright (c) 2025 Nordic Semiconductor ASA
#
# SPDX-License-Identifier: LicenseRef-Nordic-5-Clause
#

menuconfig NFC_DRIVER_STM
	bool "ST25R series device driver"

if NFC_DRIVER_STM

rsource "Kconfig.defconfig"
rsource "Kconfig.rfal"
rsource "Kconfig.pal"
rsource "nfc_configs/Kconfig"

choice
	prompt "Select ST25R driver"
	default ST25R200_DRV

config ST25R3911_DRV
	bool "NFC ST25R3911 driver"

config ST25R3916_DRV
	bool "NFC ST25R3916 driver"

config ST25R3916B_DRV
	bool "NFC ST25R3916B driver"

config ST25R200_DRV
	bool "NFC ST25R200/ST25R100 driver"

config ST25R500_DRV
	bool "NFC ST25R500/ST25R300 driver"

endchoice

module = NFC
module-str = NFC_DRV
module-dep = LOG
module-help = Enables driver log messages.
source "$(ZEPHYR_BASE)/subsys/logging/Kconfig.template.log_config"

endif # NFC_DRIVER_STM
```

## drivers/nfc/stm/Kconfig.pal
```kconfig
#
# Copyright (c) 2025 Nordic Semiconductor ASA
#
# SPDX-License-Identifier: LicenseRef-Nordic-5-Clause
#

config RFAL_MAX_TIMERS_NUM
    int "Maximum number of timers used by RFAL"
    default 10
    help
        Defines the size of the timer array, setting the maximum number of timers that can be used by RFAL.
```
