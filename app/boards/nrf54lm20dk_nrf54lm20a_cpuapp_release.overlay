/*
 * Copyright (c) 2025 Nordic Semiconductor ASA
 *
 * SPDX-License-Identifier: LicenseRef-Nordic-5-Clause
 */

#include "nrf54lm20dk_nrf54lm20a_cpuapp.overlay"

&uart30 {
	status = "disabled";
};

&pwm20 {
	status = "disabled";
};

&usbhs {
	status = "disabled";
};

&spi22 {
	status = "disabled";
};

