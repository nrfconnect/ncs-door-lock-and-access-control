/*
 * Copyright (c) 2026 Nordic Semiconductor ASA
 *
 * SPDX-License-Identifier: LicenseRef-Nordic-5-Clause
 */

#include <door_lock/common/nrf5340_cpunet_partitions.dtsi>

/ {
	chosen {
		zephyr,code-partition = &b0n_partition;
	};
};
