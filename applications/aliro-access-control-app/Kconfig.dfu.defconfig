## applications/aliro-access-control-app/Kconfig.dfu.defconfig
```kconfig
#
# Copyright (c) 2026 Nordic Semiconductor ASA
#
# SPDX-License-Identifier: LicenseRef-Nordic-5-Clause
#

config MCUMGR
	default y

config ZCBOR
	default y

config STREAM_FLASH
	default y

config IMG_MANAGER
	default y

config MCUMGR_GRP_IMG
	default y

config MCUMGR_GRP_OS
	default y

config MCUMGR_TRANSPORT_BT
	default y

config MCUMGR_TRANSPORT_BT_REASSEMBLY
	default y

choice MCUMGR_TRANSPORT_BT_PERM
	default MCUMGR_TRANSPORT_BT_PERM_RW
endchoice

config MCUMGR_TRANSPORT_NETBUF_COUNT
	default 6

# Must fit MAX MTU + overhead; the single-image DFU default of 384 B is too small.
config MCUMGR_TRANSPORT_NETBUF_SIZE
	default 1024

config MCUMGR_MGMT_NOTIFICATION_HOOKS
	default y

config MCUMGR_GRP_IMG_STATUS_HOOKS
	default y

config MCUMGR_GRP_IMG_UPLOAD_CHECK_HOOK
	default y

config MCUMGR_SMP_COMMAND_STATUS_HOOKS
	default y

# Custom SMP request to erase the settings partition.
config MCUMGR_GRP_ZBASIC
	default y

config MCUMGR_GRP_ZBASIC_STORAGE_ERASE
	default y
```

## applications/aliro-access-control-app/Kconfig.wifi.defconfig
```kconfig
#
# Copyright (c) 2026 Nordic Semiconductor ASA
#
# SPDX-License-Identifier: LicenseRef-Nordic-5-Clause
#

config WIFI
	default y

config WIFI_NM_WPA_SUPPLICANT
	default y

config WIFI_CREDENTIALS
	default y

config NET_L2_WIFI_SHELL
	default y if DOOR_LOCK_CLI

config NET_SHELL
	default y if DOOR_LOCK_CLI

config NET_CONNECTION_MANAGER
	default y

config NET_CONNECTION_MANAGER_MONITOR_STACK_SIZE
	default 5000

config L2_WIFI_CONNECTIVITY
	default y

config L2_WIFI_CONNECTIVITY_AUTO_CONNECT
	default y

config L2_WIFI_CONNECTIVITY_AUTO_DOWN
	default n

config NETWORKING
	default y

config NET_L2_ETHERNET
	default y

config NET_IPV4
	default y

config NET_IPV6
	default n

config NET_DHCPV4
	default y

# Log the connection state and the DHCPv4 address from the network stack
config NET_LOG
	default y

config WIFI_NM_WPA_SUPPLICANT_DEBUG_LEVEL
	default 3

config ZVFS_POLL_MAX
	default 12

config NET_MGMT_EVENT_QUEUE_TIMEOUT
	default 5000

if NET_BUF_VARIABLE_DATA_SIZE

config NET_PKT_BUF_TX_DATA_POOL_SIZE
	default 50000

config NET_PKT_BUF_RX_DATA_POOL_SIZE
	default 20000

endif # NET_BUF_VARIABLE_DATA_SIZE
```

## applications/aliro-access-control-app/sample.yaml
```yaml
sample:
  description: Door lock sample application
  name: ncs-door-lock-sample
common:
  sysbuild: true
  build_only: true
tests:
  smoke.door_lock.nfc.bt_nus:
    platform_allow: &platform_54l15_54lm20
      - nrf54l15dk/nrf54l15/cpuapp
      - nrf54lm20dk/nrf54lm20b/cpuapp
    integration_platforms: *platform_54l15_54lm20
    extra_args:
      - aliro-access-control-app_SNIPPET="bt_nus"
      - CONFIG_DOOR_LOCK_DFU_SMP_SERVICE=n
  app.door_lock.nfc:
    platform_allow: &platform_52840_5340
      - nrf52840dk/nrf52840
      - nrf5340dk/nrf5340/cpuapp
    integration_platforms: *platform_52840_5340
    extra_args:
      - CONFIG_DOOR_LOCK_DFU_SMP_SERVICE=n
  smoke.door_lock.nfc-uwb_stub:
    platform_allow:
      - nrf5340dk/nrf5340/cpuapp
    integration_platforms:
      - nrf5340dk/nrf5340/cpuapp
    extra_args:
      - CONFIG_DOOR_LOCK_BLE_UWB=y
      - CONFIG_DOOR_LOCK_DFU_SMP_SERVICE=n
  app.door_lock.nfc.aliro_minimal:
    platform_allow: &platform_54l15
      - nrf54l15dk/nrf54l15/cpuapp
    integration_platforms: *platform_54l15
    extra_args:
      - CONFIG_DOOR_LOCK_EXPEDITED_FAST_PHASE=n
      - CONFIG_DOOR_LOCK_STEP_UP_PHASE=n
      - CONFIG_DOOR_LOCK_CREDENTIAL_ISSUER_CA=n
      - CONFIG_DOOR_LOCK_READER_CERTIFICATE=n
      - CONFIG_DOOR_LOCK_DFU_SMP_SERVICE=n
  app.door_lock.nfc.smp_dfu-bt_nus:
    tags:
      - dfu_supported
    platform_allow: &platform_5340_54lm20
      - nrf5340dk/nrf5340/cpuapp
      - nrf54lm20dk/nrf54lm20b/cpuapp
    integration_platforms: *platform_5340_54lm20
    extra_args:
      - aliro-access-control-app_SNIPPET="bt_nus"
  app.door_lock.nfc.smp_dfu-bt_nus-release:
    tags:
      - dfu_supported
    platform_allow: &platform_all
      - nrf52840dk/nrf52840
      - nrf5340dk/nrf5340/cpuapp
      - nrf54l15dk/nrf54l15/cpuapp
      - nrf54lm20dk/nrf54lm20b/cpuapp
    integration_platforms: *platform_all
    extra_args:
      - aliro-access-control-app_SNIPPET="bt_nus"
      - FILE_SUFFIX=release
```

## applications/aliro-access-control-app/src/Kconfig
```kconfig
#
# Copyright (c) 2026 Nordic Semiconductor ASA
#
# SPDX-License-Identifier: LicenseRef-Nordic-5-Clause
#

rsource "aliro/Kconfig"

DT_CHOSEN_Z_WIFI := zephyr,wifi

config DOOR_LOCK_WIFI
	bool "Wi-Fi station support"
	depends on $(dt_chosen_enabled,$(DT_CHOSEN_Z_WIFI))
	help
	  Enable Wi-Fi station mode. The device connects to the network
	  whose credentials are stored using the Wi-Fi credentials library.
```

## applications/aliro-access-control-app/src/aliro/storage/Kconfig
```kconfig
#
# Copyright (c) 2025 Nordic Semiconductor ASA
#
# SPDX-License-Identifier: LicenseRef-Nordic-5-Clause
#

menu "Storage"

config DOOR_LOCK_ALIRO_PSA_KEY_ID_RANGE_BASE
	hex "PSA key ID range base"
	default 0x40000
	help
	  Start of the PSA key ID range reserved for Aliro keys.
	  All Aliro key IDs are derived as offsets from this base value.

config DOOR_LOCK_ALIRO_PSA_PROTECTED_STORAGE_UID_BASE
	hex "PSA Protected Storage UID base"
	default 0x500000000
	help
	  Base PSA Protected Storage UID used by Aliro reader data objects.
	  Per-object UIDs are derived from this base using fixed offsets.

config DOOR_LOCK_STORAGE_MAX_STORED_ACCESS_DOCUMENTS
    int "Maximum number of stored Access Documents"
    default 0 if SOC_SERIES_NRF52
    default 5 if DOOR_LOCK_STEP_UP_PHASE
    default 0
    help
      Specifies the maximum number of Access Documents that can be
      stored. This determines the size of the statically allocated array
      for Access Document storage.

config DOOR_LOCK_STORAGE_MAX_STORED_ACCESS_DOCUMENT_SIZE
    int "Maximum size of the stored Access Document"
    default 55 if DOOR_LOCK_STEP_UP_PHASE
    default 0
    help
      Specifies the maximum size of the stored Access Document.

config DOOR_LOCK_STORAGE_MIGRATE_ACCESS_DOCUMENT_V1
    bool "Remove version 1 Access Documents (DEPRECATED)"
    default y
    depends on DOOR_LOCK_STEP_UP_PHASE
    select DEPRECATED
    help
      Deprecated migration option. Enable it only on firmware that may contain
      version 1 Access Documents, then disable it once migration is no longer
      needed. Version 1 documents cannot be converted to version 2 because they
      do not contain a validity period, so they are removed and restored through
      the normal Step-up flow.

endmenu # Storage
```

## applications/matter-aliro-door-lock-app/sample.yaml
```yaml
sample:
  description: Door lock sample application
  name: ncs-door-lock-sample
common:
  sysbuild: true
  build_only: true
tests:
  app.door_lock.nfc.matter-ci_ca_key-reader_cert:
    tags:
      - dfu_supported
    platform_allow: &platform_54l15_54lm20
      - nrf54l15dk/nrf54l15/cpuapp
      - nrf54lm20dk/nrf54lm20b/cpuapp
    integration_platforms: *platform_54l15_54lm20
    extra_args:
      - CONFIG_DOOR_LOCK_CREDENTIAL_ISSUER_CA=y
      - CONFIG_DOOR_LOCK_READER_CERTIFICATE=y
  smoke.door_lock.nfc.matter-ci_ca_key-reader_cert:
    tags:
      - dfu_supported
    platform_allow: &platform_52840_5340
      - nrf52840dk/nrf52840
      - nrf5340dk/nrf5340/cpuapp
    integration_platforms: *platform_52840_5340
    extra_args:
      - CONFIG_DOOR_LOCK_CREDENTIAL_ISSUER_CA=y
      - CONFIG_DOOR_LOCK_READER_CERTIFICATE=y
  app.door_lock.nfc.matter-aliro_minimal:
    tags:
      - dfu_supported
    platform_allow: &platform_54l15
      - nrf54l15dk/nrf54l15/cpuapp
    integration_platforms: *platform_54l15
    extra_args:
      - CONFIG_DOOR_LOCK_EXPEDITED_FAST_PHASE=n
      - CONFIG_DOOR_LOCK_STEP_UP_PHASE=n
      - CONFIG_DOOR_LOCK_CREDENTIAL_ISSUER_CA=n
      - CONFIG_DOOR_LOCK_READER_CERTIFICATE=n
  app.door_lock.nfc.matter-bt_nus-release:
    tags:
      - dfu_supported
    platform_allow: &platform_all
      - nrf52840dk/nrf52840
      - nrf5340dk/nrf5340/cpuapp
      - nrf54l15dk/nrf54l15/cpuapp
      - nrf54lm20dk/nrf54lm20b/cpuapp
    integration_platforms: *platform_all
    extra_args:
      - matter-aliro-door-lock-app_SNIPPET="bt_nus"
      - FILE_SUFFIX=release
  do_not_test.door_lock.nfc.matter-nfc_prop-matter_ext:
    platform_allow: &platform_54lm20
      - nrf54lm20dk/nrf54lm20b/cpuapp
    integration_platforms: *platform_54lm20
    extra_args:
      - CONFIG_NCS_DOOR_LOCK_APP_EXTENSIONS_NFC=y
      - CONFIG_NCS_DOOR_LOCK_APP_EXTENSIONS_MATTER=y
  sonarqube.door_lock:
    tags:
      - sonarqube
    platform_allow: *platform_54lm20
    integration_platforms: *platform_54lm20
    extra_args:
      - CONFIG_DOOR_LOCK_CREDENTIAL_ISSUER_CA=y
      - CONFIG_DOOR_LOCK_READER_CERTIFICATE=y
```

## subsys/aliro/interface_impl/Kconfig
```kconfig
#
# Copyright (c) 2026 Nordic Semiconductor ASA
#
# SPDX-License-Identifier: LicenseRef-Nordic-5-Clause
#

menu "Aliro Interface Implementation"

rsource "os/Kconfig"
rsource "log/Kconfig"
rsource "uwb/Kconfig"
rsource "reader/Kconfig"
rsource "crypto/Kconfig"
rsource "ci_cert/Kconfig"

endmenu
```

## subsys/aliro/interface_impl/ci_cert/Kconfig
```kconfig
#
# Copyright (c) 2026 Nordic Semiconductor ASA
#
# SPDX-License-Identifier: LicenseRef-Nordic-5-Clause
#

config DOOR_LOCK_ALIRO_INTERFACE_IMPL_CI_CERT
	bool "Aliro Interface Implementation - Credential Issuer Certificate"
	depends on NCS_ALIRO
	depends on DOOR_LOCK_ALIRO_CRYPTO_UTILS
	help
	  Common implementation of Aliro::Interface::CredentialIssuerCertificate.

if DOOR_LOCK_ALIRO_INTERFACE_IMPL_CI_CERT

module = DOOR_LOCK_ALIRO_INTERFACE_IMPL_CI_CERT
module-str = Door Lock Aliro Interface Implementation Ci Cert
source "$(ZEPHYR_BASE)/subsys/logging/Kconfig.template.log_config"

config DOOR_LOCK_ALIRO_INTERFACE_IMPL_CI_CERT_VALIDATION
	bool "Credential Issuer certificate validation"
	select MBEDTLS
	select MBEDTLS_X509_LIBRARY
	help
	  When enabled, Credential Issuer certificates are validated.
	  When disabled, Validate() returns ALIRO_ERROR_NOT_IMPLEMENTED.

endif # DOOR_LOCK_ALIRO_INTERFACE_IMPL_CI_CERT
```

## subsys/aliro/interface_impl/crypto/Kconfig
```kconfig
#
# Copyright (c) 2026 Nordic Semiconductor ASA
#
# SPDX-License-Identifier: LicenseRef-Nordic-5-Clause
#

config DOOR_LOCK_ALIRO_INTERFACE_IMPL_CRYPTO
	bool "Aliro Interface Implementation - Crypto"
	depends on NCS_ALIRO
	depends on DOOR_LOCK_ALIRO_CRYPTO_UTILS
	depends on DOOR_LOCK_ALIRO_READER_STORAGE
	select PSA_WANT_ALG_ECDH
	select PSA_WANT_KEY_TYPE_ECC_KEY_PAIR_GENERATE
	select PSA_WANT_ALG_HKDF
	select PSA_WANT_ALG_HMAC
	select PSA_WANT_KEY_TYPE_HMAC
	select PSA_WANT_ALG_GCM
	select PSA_WANT_GENERATE_RANDOM
	select PSA_WANT_ALG_ECB_NO_PADDING if NCS_ALIRO_BLE_UWB
	help
	  Common implementation of Aliro::Interface::Crypto.

if DOOR_LOCK_ALIRO_INTERFACE_IMPL_CRYPTO

module = DOOR_LOCK_ALIRO_INTERFACE_IMPL_CRYPTO
module-str = Door Lock Aliro Interface Implementation Crypto
source "$(ZEPHYR_BASE)/subsys/logging/Kconfig.template.log_config"

config DOOR_LOCK_ALIRO_INTERFACE_IMPL_CRYPTO_PSA_AEAD_SINGLE_PART
	bool
	default y if SOC_NRF54LM20A || SOC_NRF54LM20B
	help
	  When enabled, the single-part AEAD API is used.

if DOOR_LOCK_ALIRO_INTERFACE_IMPL_CRYPTO_PSA_AEAD_SINGLE_PART

config DOOR_LOCK_ALIRO_INTERFACE_IMPL_CRYPTO_PSA_AEAD_SINGLE_PART_BUFFER_SIZE
	int "Maximum size of the buffer used for the single-part AEAD API"
	default 256
	help
	  Maximum size of the buffer used for the single-part AEAD API.

endif # DOOR_LOCK_ALIRO_INTERFACE_IMPL_CRYPTO_PSA_AEAD_SINGLE_PART

endif # DOOR_LOCK_ALIRO_INTERFACE_IMPL_CRYPTO
```

## subsys/aliro/interface_impl/log/Kconfig
```kconfig
#
# Copyright (c) 2026 Nordic Semiconductor ASA
#
# SPDX-License-Identifier: LicenseRef-Nordic-5-Clause
#

config DOOR_LOCK_ALIRO_INTERFACE_IMPL_LOG
	bool "Aliro Interface Implementation - Log"
	depends on NCS_ALIRO
	help
	  Common implementation of Aliro::Interface::Logging.
```

## subsys/aliro/interface_impl/os/Kconfig
```kconfig
#
# Copyright (c) 2026 Nordic Semiconductor ASA
#
# SPDX-License-Identifier: LicenseRef-Nordic-5-Clause
#

config DOOR_LOCK_ALIRO_INTERFACE_IMPL_OS
	bool "Aliro Interface Implementation - Os"
	depends on NCS_ALIRO
	depends on DOOR_LOCK_ALIRO_WORKQUEUE
	help
	  Common implementation of Aliro::Interface::Os.

if DOOR_LOCK_ALIRO_INTERFACE_IMPL_OS

module = DOOR_LOCK_ALIRO_INTERFACE_IMPL_OS
module-str = Door Lock Aliro Interface Implementation Os
source "$(ZEPHYR_BASE)/subsys/logging/Kconfig.template.log_config"

config DOOR_LOCK_ALIRO_INTERFACE_IMPL_OS_BLE_STACK_TIMERS
	int "Number of stack timer slots for Bluetooth LE sessions"
	default 0
	help
	  Number of Aliro stack timer slots reserved for Bluetooth LE sessions.

config DOOR_LOCK_ALIRO_INTERFACE_IMPL_OS_TIMER_INIT_PRIORITY
	int "Os timer init priority"
	default APPLICATION_INIT_PRIORITY
	help
	  SYS_INIT priority for Os timer slot initialization.

endif # DOOR_LOCK_ALIRO_INTERFACE_IMPL_OS
```

## subsys/aliro/interface_impl/reader/Kconfig
```kconfig
#
# Copyright (c) 2026 Nordic Semiconductor ASA
#
# SPDX-License-Identifier: LicenseRef-Nordic-5-Clause
#

config DOOR_LOCK_ALIRO_INTERFACE_IMPL_READER
	bool "Aliro Interface Implementation - Reader"
	depends on NCS_ALIRO
	depends on DOOR_LOCK_ALIRO_READER_STORAGE
	help
	  Common implementation of Aliro::Interface::Reader.
```

## subsys/aliro/interface_impl/uwb/Kconfig
```kconfig
#
# Copyright (c) 2026 Nordic Semiconductor ASA
#
# SPDX-License-Identifier: LicenseRef-Nordic-5-Clause
#

config DOOR_LOCK_ALIRO_INTERFACE_IMPL_UWB
	bool "Aliro Interface Implementation - Uwb"
	depends on NCS_ALIRO
	depends on NCS_ALIRO_BLE_UWB
	help
	  Common implementation of Aliro::Interface::Uwb.

if DOOR_LOCK_ALIRO_INTERFACE_IMPL_UWB

module = DOOR_LOCK_ALIRO_INTERFACE_IMPL_UWB
module-str = Door Lock Aliro Interface Implementation Uwb
source "$(ZEPHYR_BASE)/subsys/logging/Kconfig.template.log_config"

endif # DOOR_LOCK_ALIRO_INTERFACE_IMPL_UWB
```

## subsys/aliro/nfc_transport/Kconfig
```kconfig
#
# Copyright (c) 2026 Nordic Semiconductor ASA
#
# SPDX-License-Identifier: LicenseRef-Nordic-5-Clause
#

menuconfig DOOR_LOCK_ALIRO_NFC_TRANSPORT
	bool "Aliro NFC transport"
	depends on NCS_ALIRO
	help
	  NFC transport used by the Aliro stack to exchange APDUs with
	  User Devices.

if DOOR_LOCK_ALIRO_NFC_TRANSPORT

choice DOOR_LOCK_ALIRO_NFC_TRANSPORT_BACKEND
	prompt "Aliro NFC transport backend"
	default DOOR_LOCK_ALIRO_NFC_TRANSPORT_BACKEND_RFAL
	help
	  Select which backend is built for the Aliro NFC transport.
	  The NfcTransport glue that connects the backend to the Aliro stack
	  is always built; this choice only controls which backend implements
	  the functions declared in nfc_transport/nfc_transport_backend.h.

config DOOR_LOCK_ALIRO_NFC_TRANSPORT_BACKEND_RFAL
	bool "ST RFAL backend"
	depends on NFC_DRIVER_STM
	depends on DOOR_LOCK_ALIRO_WORKQUEUE
	select RFAL_FEATURE_NFCA
	select RFAL_FEATURE_LOWPOWER_MODE
	select RFAL_FEATURE_WAKEUP_MODE
	select RFAL_FEATURE_T4T
	select RFAL_FEATURE_ISO_DEP
	select RFAL_FEATURE_ISO_DEP_POLL
	help
	  Build the in-tree backend from the rfal_backend directory, based on
	  the ST RFAL library and ST25R-series transceivers.

config DOOR_LOCK_ALIRO_NFC_TRANSPORT_BACKEND_EXTERNAL
	bool "Out-of-tree backend"
	help
	  Do not build any in-tree NFC transport backend. An external module
	  defines the functions declared in nfc_transport/nfc_transport_backend.h.

endchoice # DOOR_LOCK_ALIRO_NFC_TRANSPORT_BACKEND

module = DOOR_LOCK_ALIRO_NFC_TRANSPORT
module-str = Door Lock Aliro NFC transport
source "$(ZEPHYR_BASE)/subsys/logging/Kconfig.template.log_config"

if DOOR_LOCK_ALIRO_NFC_TRANSPORT_BACKEND_RFAL
rsource "rfal_backend/Kconfig"
endif

endif # DOOR_LOCK_ALIRO_NFC_TRANSPORT
```
