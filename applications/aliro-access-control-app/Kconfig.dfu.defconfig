## subsys/aliro/nfc_transport/rfal_backend/Kconfig
```kconfig
#
# Copyright (c) 2026 Nordic Semiconductor ASA
#
# SPDX-License-Identifier: LicenseRef-Nordic-5-Clause
#

menu "ST RFAL backend"

# Prompt-less option only for internal tuning of the RFAL worker.
config DOOR_LOCK_ALIRO_NFC_TRANSPORT_RFAL_WORKER_INTERVAL_MS
	int
	default 10

config DOOR_LOCK_ALIRO_NFC_TRANSPORT_RFAL_DISCOVERY_DEV_LIMIT
	int "Maximum number of devices to discover"
	range 1 10
	default 1
	help
	  Maximum number of NFC devices to discover in a single polling cycle.

config DOOR_LOCK_ALIRO_NFC_TRANSPORT_RFAL_DISCOVERY_TOTAL_DURATION_MS
	int "Total duration of each polling cycle (ms)"
	range 10 2000
	default 50
	help
	  Total duration of each polling cycle in milliseconds.

choice DOOR_LOCK_ALIRO_NFC_TRANSPORT_RFAL_DISCOVERY_COMP_MODE
	prompt "RFAL compliance mode"
	default DOOR_LOCK_ALIRO_NFC_TRANSPORT_RFAL_DISCOVERY_COMP_MODE_EMV

config DOOR_LOCK_ALIRO_NFC_TRANSPORT_RFAL_DISCOVERY_COMP_MODE_EMV
	bool "EMVCo compliance"

config DOOR_LOCK_ALIRO_NFC_TRANSPORT_RFAL_DISCOVERY_COMP_MODE_ISO
	bool "ISO/IEC 14443 compliance"

endchoice # DOOR_LOCK_ALIRO_NFC_TRANSPORT_RFAL_DISCOVERY_COMP_MODE

config DOOR_LOCK_ALIRO_NFC_TRANSPORT_RFAL_DISCOVERY_MAX_BR
	int "Maximum bitrate for NFC communication"
	range 0 3
	default 3
	help
	  0 = 106 kbps, 1 = 212 kbps, 2 = 424 kbps, 3 = 848 kbps

config DOOR_LOCK_ALIRO_NFC_TRANSPORT_RFAL_DISCOVERY_GBLEN
	int "General Bytes length for P2P"
	range 0 48
	default 0
	help
	  Length of General Bytes for NFC-DEP P2P activation.

config DOOR_LOCK_ALIRO_NFC_TRANSPORT_RFAL_REMOVAL_DETECTION
	bool "Wait for User Device removal before starting a new transaction"
	default y
	help
	  After an NFC transaction ends, keep the User Device asleep in the field and
	  periodically check its presence. Discovery of a new User Device is resumed only
	  after the previous one has been removed, which prevents repeated transactions
	  when the User Device stays near the reader.

if DOOR_LOCK_ALIRO_NFC_TRANSPORT_RFAL_REMOVAL_DETECTION

config DOOR_LOCK_ALIRO_NFC_TRANSPORT_RFAL_REMOVAL_CHECK_INTERVAL_MS
	int "Interval between User Device presence checks (ms)"
	range 20 1000
	default 100

config DOOR_LOCK_ALIRO_NFC_TRANSPORT_RFAL_REMOVAL_MISSED_POLLS
	int "Number of missed presence checks to consider the User Device removed"
	range 1 20
	default 3

config DOOR_LOCK_ALIRO_NFC_TRANSPORT_RFAL_REMOVAL_TIMEOUT_MS
	int "Maximum time to wait for User Device removal (ms)"
	range 0 600000
	default 30000
	help
	  When the User Device is not removed within this time, discovery is resumed and
	  a new transaction can be started. Set to 0 to wait for removal indefinitely,
	  which keeps the RF field on for as long as the User Device stays in the field.

endif # DOOR_LOCK_ALIRO_NFC_TRANSPORT_RFAL_REMOVAL_DETECTION

endmenu # ST RFAL backend
```

## subsys/aliro/uwb/Kconfig
```kconfig
#
# Copyright (c) 2025 Nordic Semiconductor ASA
#
# SPDX-License-Identifier: LicenseRef-Nordic-5-Clause
#

menu "UWB"

config DOOR_LOCK_ALIRO_UWB
	bool "Enable Aliro UWB support"

if DOOR_LOCK_ALIRO_UWB

choice DOOR_LOCK_ALIRO_UWB_IMPL
	prompt "Aliro UWB implementation"
	default DOOR_LOCK_ALIRO_UWB_IMPL_STUB
	help
	  Select which UltraWideBand implementation is built for the Aliro UWB
	  subsystem. The generic UltraWideBand facade is always built; this
	  choice only controls which backend provides the implementation
	  (uwb_impl.h and its sources).

config DOOR_LOCK_ALIRO_UWB_IMPL_STUB
	bool "In-tree stub implementation"
	help
	  Build the generic in-tree implementation from the stub_impl
	  directory. All operations return -ENOSYS. Use it as a starting point
	  for integrating a real UWB backend.

config DOOR_LOCK_ALIRO_UWB_IMPL_EXTERNAL
	bool "Out-of-tree implementation"
	help
	  Do not build any in-tree UWB implementation. An external module
	  provides the UltraWideBand implementation (uwb_impl.h and its sources)
	  through the external-provider seam. Select this when using an
	  out-of-tree UWB provider module.

endchoice # DOOR_LOCK_ALIRO_UWB_IMPL

config DOOR_LOCK_ALIRO_UWB_RADAR
	bool "Enable UWB radar session support"
	help
	  Enable UWB radar sessions. When enabled, the application drives the
	  radar session (start/stop) through the vendor-agnostic UltraWideBand
	  facade. The active UWB implementation must support radar operations

module = DOOR_LOCK_ALIRO_UWB
module-str = DOOR_LOCK_ALIRO_UWB
module-dep = LOG
module-help = Enables Door Lock Aliro UWB platform log messages.
source "$(ZEPHYR_BASE)/subsys/logging/Kconfig.template.log_config"

endif # DOOR_LOCK_ALIRO_UWB

endmenu # UWB
```

## subsys/coap_service/Kconfig
```kconfig
#
# Copyright (c) 2026 Nordic Semiconductor ASA
#
# SPDX-License-Identifier: LicenseRef-Nordic-5-Clause
#

menuconfig DOOR_LOCK_COAP_SERVICE
	bool "Door Lock CoAP service"
	depends on NETWORKING && NET_IPV4 && NET_UDP
	depends on NCS_ALIRO
	select CPP
	select ZCBOR
	select COAP
	select COAP_SERVER
	help
	  Enables an IPv4 CoAP service for reading and changing the door lock
	  state. The service uses plain UDP without authentication or encryption.
	  Use only on a trusted test network.

if DOOR_LOCK_COAP_SERVICE

module = DOOR_LOCK_COAP_SERVICE
module-str = Door Lock CoAP service
module-dep = LOG
source "$(ZEPHYR_BASE)/subsys/logging/Kconfig.template.log_config"

config DOOR_LOCK_COAP_SERVICE_PORT
	int "Door Lock CoAP service UDP port"
	default 5683
	range 1 65535
	help
	  Sets the UDP port used by the door lock CoAP service.
	  Port 5683 is the standard port for unsecured CoAP. Port 0
	  (automatic ephemeral port assignment) is not supported.

config DOOR_LOCK_COAP_RESOURCE_PATH
	string "Door Lock CoAP service resource path"
	default "door-lock"
	help
	  Sets the single URI path segment of the door lock resource, for
	  example "door-lock". The value must not be empty or contain slashes.
	  Specify an unescaped value, not percent-encoded text.
	  The path must fit in a CoAP option value (12 bytes by default).
	  Longer values require COAP_EXTENDED_OPTIONS_LEN and an appropriate
	  COAP_EXTENDED_OPTIONS_LEN_VALUE.

endif # DOOR_LOCK_COAP_SERVICE
```

## tests/functional/subsys/aliro/interface_impl/crypto/testcase.yaml
```yaml
tests:
  door_lock.functional.subsys.aliro.interface_impl.crypto:
    sysbuild: true
    platform_allow: &platforms
      - nrf52840dk/nrf52840
      - nrf5340dk/nrf5340/cpuapp
      - nrf54l15dk/nrf54l15/cpuapp
      - nrf54lm20dk/nrf54lm20b/cpuapp
    integration_platforms: *platforms
```

## west.yml
```yaml
# Copyright (c) 2025 Nordic Semiconductor ASA
# SPDX-License-Identifier: Apache-2.0

manifest:
  self:
    west-commands: scripts/west-commands.yml
  remotes:
    - name: ncs
      url-base: https://github.com/nrfconnect
  projects:
    - name: nrf
      remote: ncs
      repo-path: sdk-nrf
      revision: 8b65ab0fb67016fb73981e0f8ea1f929e23c3194 # v3.5.0-preview2
      import:
        name-blocklist:
          - matter
    - name: ncs-matter
      remote: ncs
      repo-path: ncs-matter
      revision: ee8f274231909b919b41365e2866917dbc439d22 # preview-nrf7120-branch
      import: true
    - name: ncs-door-lock-app-extensions
      remote: ncs
      repo-path: ncs-door-lock-app-extensions
      revision: v1.2.0
      groups:
        - ncs-door-lock-app-extensions
  group-filter:
    - -ncs-door-lock-app-extensions
```
