/*
 * Copyright (c) 2025 Nordic Semiconductor ASA
 *
 * SPDX-License-Identifier: LicenseRef-Nordic-5-Clause
 */

#include <door_lock/common/nrf54lm20_cpuapp_internal_partitions.dtsi>

/ {
	chosen {
		zephyr,code-partition = &boot_partition;
	};
};

&mx25r64 {
	status = "disabled";
};
