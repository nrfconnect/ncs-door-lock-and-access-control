/*
 * Copyright (c) 2023 Nordic Semiconductor ASA
 *
 * SPDX-License-Identifier: LicenseRef-Nordic-5-Clause
 */

#include <door_lock/common/nrf52840_partitions.dtsi>

/ {
	chosen {
		zephyr,code-partition = &boot_partition;
		nordic,pm-ext-flash = &mx25r64;
	};
};
