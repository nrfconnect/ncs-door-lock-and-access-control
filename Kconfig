## app/src/aliro/platform/nfc_transport_impl/Kconfig
```kconfig
#
# Copyright (c) 2025 Nordic Semiconductor ASA
#
# SPDX-License-Identifier: LicenseRef-Nordic-5-Clause
#

rsource "Kconfig.rfal.defconfig"

# Prompt-less option only for internal tuning of the RFAL worker thread. Do not change it.
config RFAL_NFC_WORKER_TIMEOUT_MS
	int
	default 30

config RFAL_DISCOVERY_DEV_LIMIT
	int "Maximum number of devices to discover"
	range 1 10
	default 1
	help
	  Maximum number of NFC devices to discover in a single polling cycle.

config RFAL_DISCOVERY_TOTAL_DURATION_MS
	int "Total duration of each polling cycle (ms)"
	range 10 2000
	default 50
	help
	  Total duration of each polling cycle in milliseconds.

choice RFAL_DISCOVERY_COMP_MODE
	prompt "RFAL compliance mode"
	default RFAL_DISCOVERY_COMP_MODE_EMV

config RFAL_DISCOVERY_COMP_MODE_EMV
	bool "EMVCo compliance"

config RFAL_DISCOVERY_COMP_MODE_ISO
	bool "ISO/IEC 14443 compliance"

endchoice # RFAL_DISCOVERY_COMP_MODE

config RFAL_DISCOVERY_MAX_BR
	int "Maximum bitrate for NFC communication"
	range 0 3
	default 3
	help
	  0 = 106 kbps, 1 = 212 kbps, 2 = 424 kbps, 3 = 848 kbps

config RFAL_DISCOVERY_GBLEN
	int "General Bytes length for P2P"
	range 0 48
	default 0
	help
	  Length of General Bytes for NFC-DEP P2P activation.

#
# Proprietary NFC Technology add-on
#

config NCS_ALIRO_NFC_PROP
	bool "Enable support for proprietary NFC Technology"
	help
	  Enable proprietary NFC technology module using RFAL PROP API.
	  This optional module implements custom NFC functionality that
	  enhances device detection capabilities. When disabled, only
	  standard NFC-A technology is used.

module = NCS_ALIRO_RFAL
module-str = ALIRO_RFAL
module-dep = LOG
module-help = Enables Aliro NFC RFAL log messages.
source "$(ZEPHYR_BASE)/subsys/logging/Kconfig.template.log_config"
```

## app/src/aliro/platform/nfc_transport_impl/Kconfig.rfal.defconfig
```kconfig
#
# Copyright (c) 2025 Nordic Semiconductor ASA
#
# SPDX-License-Identifier: LicenseRef-Nordic-5-Clause
#

config NFC_DRIVER_STM
	default y

config RFAL_FEATURE_NFCA
	default y

config RFAL_FEATURE_WAKEUP_MODE
	default y

config RFAL_FEATURE_T4T
	default y

config RFAL_FEATURE_ISO_DEP
	default y

config RFAL_FEATURE_ISO_DEP_POLL
	default y
```

## app/src/aliro/platform/uwb_impl/Kconfig
```kconfig
#
# Copyright (c) 2025 Nordic Semiconductor ASA
#
# SPDX-License-Identifier: LicenseRef-Nordic-5-Clause
#
menu "UWB"

config TIMESYNC_PROCEDURE_0
	bool "Enable timesync Procedure 0"
	help
	  Enable the BLE and UWB time synchronization Procedure 0.

config TIMESYNC_PROCEDURE_1
	bool "Enable timesync Procedure 1"
	help
	  Enable the BLE and UWB time synchronization Procedure 1.

config TSRR250_UWB_ALIRO_ZEPHYR
	bool "TrueSense TSRR250 UWB Aliro implementation"
	depends on SOC_NRF54LM20A
	help
	  Enable the Aliro UWB platform backend for the TrueSense TSRR250 module
	  based on the NXP Trimension SR250. This selects the app-side backend and
	  board wiring. The NXP SR250 UWB API port still needs to be linked before
	  real ranging can be started.

if TSRR250_UWB_ALIRO_ZEPHYR
rsource "uwb_tsrr250_impl/Kconfig"
endif # TSRR250_UWB_ALIRO_ZEPHYR

if QM35_UWB_ALIRO_ZEPHYR || QM35_UWB_LIB
rsource "uwb_qm35_impl/Kconfig"
endif # QM35_UWB_ALIRO_ZEPHYR || QM35_UWB_LIB

module = DOOR_LOCK_UWB
module-str = DOOR_LOCK_UWB
module-dep = LOG
module-help = Enables Door Lock UWB platform log messages.
source "$(ZEPHYR_BASE)/subsys/logging/Kconfig.template.log_config"

endmenu # UWB
```

## app/src/aliro/platform/uwb_impl/uwb_qm35_impl/Kconfig
```kconfig
#
# Copyright (c) 2025 Nordic Semiconductor ASA
#
# SPDX-License-Identifier: LicenseRef-Nordic-5-Clause
#

config DOOR_LOCK_UWB_MIN_RAN_MULTIPLIER
	int "Minimum RAN multiplier for UWB ranging blocks"
	default 2
	range 1 255
	help
	  The RAN multiplier allows to define the time between 2 ranging blocks.
	  The time range is between 96 ms (RAN multiplier is 1) and 24480 ms
	  (RAN multiplier is 255).

config DOOR_LOCK_UWB_MAC_MODE_OFFSET
	int "Offset between ranging blocks in MAC mode"
	default 0
	range 0 63
	help
	  Offset between the 2 ranging blocks.

config DOOR_LOCK_UWB_MAC_MODE_RANGING_ROUNDS
	int "Number of ranging rounds per ranging block"
	default 0
	range 0 1
	help
	  Number of ranging rounds used in a ranging block.
	  Values:
	  - 0: 1 ranging round
	  - 1: 2 ranging round

config DOOR_LOCK_UWB_SESSION_LOGGING
	bool "Enable UWB session state logging"
	help
	  Enable logging for UWB session states and reason codes.
```

## app/src/aliro/platform/uwb_impl/uwb_tsrr250_impl/Kconfig
```kconfig
#
# Copyright (c) 2026 Nordic Semiconductor ASA
#
# SPDX-License-Identifier: LicenseRef-Nordic-5-Clause
#

config TSRR250_UWB_SPI_MAX_FREQUENCY
	int "TSRR250 SPI maximum frequency"
	default 8000000
	help
	  Target SPI frequency for the SR250 transport layer. Keep this aligned
	  with the devicetree overlay and the NXP UWB API port.

config DOOR_LOCK_UWB_MIN_RAN_MULTIPLIER
	int "Minimum RAN multiplier for UWB ranging blocks"
	default 1
	range 1 255
	help
	  Minimum RAN multiplier advertised in Aliro UWB RSS-M1.

config DOOR_LOCK_UWB_MAC_MODE_OFFSET
	int "Offset between ranging blocks in MAC mode"
	default 0
	range 0 63
	help
	  Offset between the two ranging blocks.

config DOOR_LOCK_UWB_MAC_MODE_RANGING_ROUNDS
	int "Number of ranging rounds per ranging block"
	default 0
	range 0 1
	help
	  Number of ranging rounds used in a ranging block.

config DOOR_LOCK_UWB_SESSION_LOGGING
	bool "Enable UWB session state logging"
	help
	  Enable logging for UWB session states and reason codes.
```

## app/src/aliro/storage/Kconfig
```kconfig
#
# Copyright (c) 2025 Nordic Semiconductor ASA
#
# SPDX-License-Identifier: LicenseRef-Nordic-5-Clause
#

menu "Storage"

config DOOR_LOCK_ALIRO_PSA_KEY_ID_RANGE_BASE
	hex "PSA key ID range base"
	default 0x40000
	help
	  Start of the PSA key ID range reserved for Aliro keys.
	  All Aliro key IDs are derived as offsets from this base value.

config DOOR_LOCK_ALIRO_PSA_PROTECTED_STORAGE_UID_BASE
	hex "PSA Protected Storage UID base"
	default 0x500000000
	help
	  Base PSA Protected Storage UID used by Aliro reader data objects.
	  Per-object UIDs are derived from this base using fixed offsets.

config DOOR_LOCK_STORAGE_MAX_STORED_ACCESS_DOCUMENTS
    int "Maximum number of stored Access Documents"
    default 0 if SOC_SERIES_NRF52X
    default 5 if DOOR_LOCK_STEP_UP_PHASE
    default 0
    help
      Specifies the maximum number of Access Documents that can be
      stored. This determines the size of the statically allocated array
      for Access Document storage.

config DOOR_LOCK_STORAGE_MAX_STORED_ACCESS_DOCUMENT_SIZE
    int "Maximum size of the stored Access Document"
    default 55 if DOOR_LOCK_STEP_UP_PHASE
    default 0
    help
      Specifies the maximum size of the stored Access Document.

endmenu # Storage
```

## app/src/bt_nus/Kconfig
```kconfig
#
# Copyright (c) 2025 Nordic Semiconductor ASA
#
# SPDX-License-Identifier: LicenseRef-Nordic-5-Clause
#

config DOOR_LOCK_BT_NUS_MAX_COMMAND_LEN
	int "Maximum length of single command in Bytes"
	default 10
	help
	  Maximum length of single command. This command will be sent via Bluetooth LE to
	  a paired smart door lock.

config DOOR_LOCK_BT_NUS_APP_PASSKEY
	int "Define the default passkey for NUS"
	depends on BT_APP_PASSKEY
	default 123456
	help
	  Define the default password for pairing with the Bluetooth LE device.

config DOOR_LOCK_BT_NUS_MAX_COMMANDS
	int "Define maximum NUS commands amount"
	default 1
	help
	  Define the maximum number of NUS commands to declare by user.
```

## app/src/dfu_smp/Kconfig
```kconfig
#
# Copyright (c) 2025 Nordic Semiconductor ASA
#
# SPDX-License-Identifier: LicenseRef-Nordic-5-Clause
#

module = DFU_SMP
module-str = DFU_SMP
module-dep = LOG
module-help = Enables DFU SMP module log messages.
source "$(ZEPHYR_BASE)/subsys/logging/Kconfig.template.log_config"
```

## app/src/matter/Kconfig
```kconfig
#
# Copyright (c) 2025 Nordic Semiconductor ASA
#
# SPDX-License-Identifier: LicenseRef-Nordic-5-Clause
#

config LOCK_PASS_CREDENTIALS_TO_SET_LOCK_STATE
	bool "Pass used credentials when setting the lock state"
	help
	  This option should stay disabled until TC-DRLK-2.3 is fixed.
	  Related issue: https://github.com/project-chip/connectedhomeip/issues/38222

config STATE_LEDS
	bool "Use LEDs to indicate the device state"
	default y
	help
	  Use LEDs to render the current state of the device such as the progress of commissioning of
	  the device into a network or the factory reset initiation. Note that setting this option to
	  'n' does not disable the LED indicating the state of the simulated bolt.

# Sample configuration used for Thread networking
if OPENTHREAD

choice OPENTHREAD_NORDIC_LIBRARY_CONFIGURATION
	default OPENTHREAD_NORDIC_LIBRARY_MTD
endchoice

choice OPENTHREAD_DEVICE_TYPE
	default OPENTHREAD_MTD
endchoice

config CHIP_ENABLE_ICD_SUPPORT
	default y

# Reduce Thread TX output power to 0 dBm for SED device
config OPENTHREAD_DEFAULT_TX_POWER
	default 0

endif # OPENTHREAD
```

## app/src/nfc_transport_impl/Kconfig
```kconfig
#
# Copyright (c) 2025 Nordic Semiconductor ASA
#
# SPDX-License-Identifier: LicenseRef-Nordic-5-Clause
#

rsource "Kconfig.rfal.defconfig"

config RFAL_RX_TIMEOUT_MS
	int "RFAL RX timeout in ms"
	default 500

config RFAL_IDLE_TIMEOUT_MS
	int "RFAL idle timeout in ms"
	default 500

# Prompt-less option only for internal tuning of the RFAL worker thread. Do not change it.
config RFAL_NFC_WORKER_TIMEOUT_MS
	int
	default 30

module = NCS_ALIRO_RFAL
module-str = ALIRO_RFAL
module-dep = LOG
module-help = Enables Aliro NFC RFAL log messages.
source "${ZEPHYR_BASE}/subsys/logging/Kconfig.template.log_config"
```

## app/src/platform/uwb_impl/Kconfig
```kconfig
#
# Copyright (c) 2025 Nordic Semiconductor ASA
#
# SPDX-License-Identifier: LicenseRef-Nordic-5-Clause
#

if QM35_UWB_ZEPHYR
rsource "uwb_qm35_impl/Kconfig.defconfig"
endif # QM35_UWB_ZEPHYR
```
