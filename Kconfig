## Kconfig
```kconfig
#
# Copyright (c) 2025 Nordic Semiconductor ASA
#
# SPDX-License-Identifier: LicenseRef-Nordic-5-Clause
#

rsource "drivers/Kconfig"
rsource "lib/Kconfig"
rsource "subsys/Kconfig"

menuconfig NCS_DOOR_LOCK
	bool "NCS Door Lock Application [EXPERIMENTAL]"
	depends on (SOC_SERIES_NRF54LX || SOC_SERIES_NRF53X || SOC_SERIES_NRF52X)
	select EXPERIMENTAL
	select NCS_ALIRO
	imply NFC_T4T_APDU
	imply POLL
	# storage
	imply SETTINGS
	imply FLASH
	imply FLASH_MAP
	imply REQUIRES_FULL_LIBCPP
	imply REQUIRES_FULL_LIBC
	imply NEWLIB_LIBC_NANO if NEWLIB_LIBC
	help
	  This option enables the Door Lock Application which uses the Aliro reader stack.

if NCS_DOOR_LOCK

orsource "lib/aliro/interfaces/logger/Kconfig"

config DOOR_LOCK_BLE_UWB
	bool "Aliro Bluetooth LE (BLE) transport together with ultra wideband (UWB)"
	select NCS_ALIRO_BLE_UWB
	help
	  Enable the Aliro BLE transport protocol (TP). This is the transport layer
	  used by the Reader to communicate with the User Device. It is used to send and
	  receive packets over BLE. Additionally the UWB is enabled in order to manage the
	  ranging between the Reader and the User Device.

if DOOR_LOCK_BLE_UWB

config DOOR_LOCK_BLE_UWB_MAX_SESSIONS
	int "Maximum number of BLE and UWB sessions"
	range 1 BT_MAX_CONN
	default BT_MAX_CONN
	help
	  The maximum number of BLE and UWB sessions that can be established.

endif # DOOR_LOCK_BLE_UWB

rsource "lib/aliro/Kconfig.defconfig"

config DOOR_LOCK_DFU_BLE_SMP
    bool "Enable DFU over SMP"
    depends on !CHIP
    help
      Enables Device Firmware Upgrade over Bluetooth LE.

config DOOR_LOCK_DFU_BLE_SMP_STANDALONE
    bool
    default y if DOOR_LOCK_DFU_BLE_SMP && !DOOR_LOCK_BLE_UWB && !DOOR_LOCK_BLE_NUS
    help
      Automatically enabled when DFU over SMP is enabled standalone (without DOOR_LOCK_BLE_UWB or DOOR_LOCK_BLE_NUS).
      This simplifies conditional compilation checks in the code.

config DOOR_LOCK_BLE_NUS
    bool "Enable Nordic Uart Service (NUS)"
    depends on !CHIP
    help
      Enables the Bluetooth LE Nordic Uart Service (NUS). Using NUS service you can control a door lock using pre-defined BLE commands.

# Source BLE defconfig when any BLE feature is enabled
if DOOR_LOCK_BLE_UWB || DOOR_LOCK_DFU_BLE_SMP || DOOR_LOCK_BLE_NUS

rsource "lib/aliro/Kconfig.ble.defconfig"

endif # DOOR_LOCK_BLE_UWB || DOOR_LOCK_DFU_BLE_SMP || DOOR_LOCK_BLE_NUS

config DOOR_LOCK_RELEASE
    bool "Enable Aliro release configuration"
    help
      In this configuration:
      Aliro stack logs are disabled.
      RFAL NFC driver logs are disabled.
      Shell commands are disabled.
      Device reset automatically on fatal error.

endif # NCS_DOOR_LOCK
```

## app/src/access_manager_impl_default/Kconfig
```kconfig
#
# Copyright (c) 2025 Nordic Semiconductor ASA
#
# SPDX-License-Identifier: LicenseRef-Nordic-5-Clause
#

config ACCESS_MANAGER_MAX_STORED_KEYS
    int "Maximum number of stored public keys"
    default 5
    help
      Specifies the maximum number of public keys that can be
      stored in the AccessManager. This determines the size of
      the statically allocated array for key storage.

if ALIRO_BLE_TP

config ACCESS_MANAGER_MAX_ALLOWED_DISTANCE_CM
    int "Maximum allowed distance for granting access (cm)"
    default 100
    help
      Specifies the maximum allowed distance provided by
      UWB ranging to grant an access (in centimeters).
      This is used to determine if the Aliro User Device
      is within the allowed proximity range.

endif # ALIRO_BLE_TP
```

## app/src/aliro/Kconfig
```kconfig
#
# Copyright (c) 2025 Nordic Semiconductor ASA
#
# SPDX-License-Identifier: LicenseRef-Nordic-5-Clause
#

menu "Aliro features"

config DOOR_LOCK_BLE_UWB
	bool "Integration with Aliro BLE and UWB [EXPERIMENTAL]"
	select NCS_ALIRO_BLE_UWB
	select EXPERIMENTAL
	help
	  Enable the door lock application integration with Aliro Bluetooth LE (BLE) and ultra wideband (UWB).

if DOOR_LOCK_BLE_UWB

config DOOR_LOCK_BLE_UWB_MAX_SESSIONS
	int "Maximum number of BLE and UWB sessions"
	range 1 BT_MAX_CONN
	default BT_MAX_CONN
	help
	  The maximum number of BLE and UWB sessions that can be established.

endif # DOOR_LOCK_BLE_UWB

config DOOR_LOCK_EXPEDITED_FAST_PHASE
    bool "Support for Aliro Expedited-fast Phase"
    default y if CHIP
    help
        If enabled, the Expedited-fast phase is supported.
        The user authentication is based on the Kpersistent keys.

config DOOR_LOCK_STEP_UP_PHASE
    bool "Support for Aliro Step-up Phase"
    default y if CHIP
    select DOOR_LOCK_EXTERNAL_NVS if !SOC_SERIES_NRF52X
    help
        If enabled, the Step-up phase is supported.
        The user authentication is based on the Access Document.

config DOOR_LOCK_CREDENTIAL_ISSUER_CA
    bool "Support for Credential Issuer CA public key"
    default y if DOOR_LOCK_STEP_UP_PHASE && !CHIP
    help
        If enabled, the Credential Issuer CA public key is supported.
        The Credential Issuer CA public key is used to verify the signature of the Credential Issuer certificate.

config DOOR_LOCK_READER_CERTIFICATE
	bool "Support for Reader certificates"
	default y if !CHIP
	help
	  Use the reader certificate for the reader authentication.

config DOOR_LOCK_CERTIFICATION_TEST_PROVISIONING
	bool "Provision Aliro certification test parameters at boot"
	depends on !CHIP
	select DOOR_LOCK_READER_CERTIFICATE
	help
	  Provision the fixed Aliro certification test credentials into persistent
	  storage during boot. This is intended only for certification and
	  interoperability test builds because it embeds known test keys in firmware.

if DOOR_LOCK_READER_CERTIFICATE

config DOOR_LOCK_READER_CERTIFICATE_MAX_SIZE
    int "Maximum size of the Reader certificate"
    default 512
    help
      Specifies the maximum size of the Reader certificate.
      The Reader certificate is used to identify the Reader.

endif # DOOR_LOCK_READER_CERTIFICATE

endmenu # Aliro features

rsource "platform/Kconfig"

if DOOR_LOCK_CLI
    rsource "cli/Kconfig"
endif

rsource "access_manager/Kconfig"
rsource "kpersistent_manager/Kconfig"
rsource "lock_sim/Kconfig"
rsource "storage/Kconfig"
rsource "aliro_work/Kconfig"
```

## app/src/aliro/access_manager_impl_default/Kconfig
```kconfig
#
# Copyright (c) 2025 Nordic Semiconductor ASA
#
# SPDX-License-Identifier: LicenseRef-Nordic-5-Clause
#

config ALIRO_CREDENTIAL_ISSUER_MAX_STORED_KEYS
    int "Maximum number of stored Credential Issuer public keys"
    default 5
    help
      Specifies the maximum number of Credential Issuer public keys that can be
      stored in the AccessManager. This determines the size of
      the statically allocated array for key storage. The Credential Issuer
      public key is used to verify the signature of the access document.
      If this option is set to 0, the access document is not supported.

config ALIRO_ACCESS_MANAGER_MAX_STORED_KEYS
    int "Maximum number of stored public keys"
    default 5
    help
      Specifies the maximum number of public keys that can be
      stored in the AccessManager. This determines the size of
      the statically allocated array for key storage.

if ALIRO_BLE_UWB

config ALIRO_ACCESS_MANAGER_MAX_ALLOWED_DISTANCE_CM
    int "Maximum allowed distance for granting access (cm)"
    default 100
    help
      Specifies the maximum allowed distance provided by
      UWB ranging to grant an access (in centimeters).
      This is used to determine if the Aliro User Device
      is within the allowed proximity range.

choice ALIRO_ACCESS_MANAGER_TERMINATE_SESSION
    prompt "Terminate session on given condition"
    default ALIRO_ACCESS_MANAGER_TERMINATE_SESSION_ON_TIMEOUT
    help
      Select the condition under which the AccessManager will
      terminate the current Aliro session.

config ALIRO_ACCESS_MANAGER_TERMINATE_SESSION_ON_ACCESS_GRANTED
    bool "Terminate the session if the access was granted"
    help
      If enabled, the AccessManager will terminate each
      session immediately when an access is granted.

config ALIRO_ACCESS_MANAGER_TERMINATE_SESSION_ON_TIMEOUT
    bool "Terminate session on timeout"
    help
      If enabled, the AccessManager will terminate each ongoing
      session if it times out according to ALIRO_ACCESS_MANAGER_SESSION_TIMEOUT_MS.

endchoice

if ALIRO_ACCESS_MANAGER_TERMINATE_SESSION_ON_TIMEOUT

config ALIRO_ACCESS_MANAGER_SESSION_TIMEOUT_MS
    int "Session timeout in milliseconds"
    default 10000

endif

endif # ALIRO_BLE_UWB
```

## app/src/aliro/aliro_work/Kconfig
```kconfig
#
# Copyright (c) 2026 Nordic Semiconductor ASA
#
# SPDX-License-Identifier: LicenseRef-Nordic-5-Clause
#

config DOOR_LOCK_ALIRO_WORKQUEUE_STACK_SIZE
	int "Aliro workqueue stack size"
	default 5120
	help
	  Stack size for the dedicated Aliro workqueue.

config DOOR_LOCK_ALIRO_WORKQUEUE_PRIORITY
	int "Aliro workqueue priority"
	default 10
```

## app/src/aliro/cli/Kconfig
```kconfig
#
# Copyright (c) 2025 Nordic Semiconductor ASA
#
# SPDX-License-Identifier: LicenseRef-Nordic-5-Clause
#

if DOOR_LOCK_CLI

config DOOR_LOCK_CLI_PROVISIONING
	bool
	default y if !CHIP || DOOR_LOCK_CREDENTIAL_ISSUER_CA

config DOOR_LOCK_CLI_READER
	bool
	default y if !CHIP || DOOR_LOCK_READER_CERTIFICATE

config SHELL_CMD_BUFF_SIZE
	# Shell buffer must fit: "dl reader certificate set " (26 chars) + hex string (2 * cert size)
	# For 512 byte cert: 26 + 1024 = 1050
	default 1052 if (SHELL && DOOR_LOCK_READER_CERTIFICATE)

endif # DOOR_LOCK_CLI
```

## app/src/aliro/dynamic_tag_control/Kconfig
```kconfig
#
# Copyright (c) 2026 Nordic Semiconductor ASA
#
# SPDX-License-Identifier: LicenseRef-Nordic-5-Clause
#

config DOOR_LOCK_DYNAMIC_TAG_CONTROL
	bool "Dynamic Tag control"
	default y
	depends on DOOR_LOCK_BLE_UWB && DOOR_LOCK_TIME_CONCEPT
	help
	  Enables periodic regeneration of the Aliro BLE Dynamic Tag with a
	  fresh expiry timestamp sourced from the Matter real-time clock.

if DOOR_LOCK_DYNAMIC_TAG_CONTROL

config DOOR_LOCK_DYNAMIC_TAG_CONTROL_EXPIRY_DURATION_S
	int "Dynamic Tag expiry duration in seconds"
	default 900
	range 1 86400
	help
	  How long the Dynamic Tag should remain valid before expiring.

endif # DOOR_LOCK_DYNAMIC_TAG_CONTROL
```

## app/src/aliro/kpersistent_manager/Kconfig
```kconfig
#
# Copyright (c) 2025 Nordic Semiconductor ASA
#
# SPDX-License-Identifier: LicenseRef-Nordic-5-Clause
#

config MAX_NUMBER_OF_KPERSISTENT
    int "Maximum number of supported Kpersistent keys"
    depends on DOOR_LOCK_EXPEDITED_FAST_PHASE
    default DOOR_LOCK_ACCESS_MANAGER_ACCESS_CREDENTIAL_MAX_STORED_KEYS if DOOR_LOCK_ACCESS_MANAGER_IMPLEMENTATION_DEFAULT
    range 1 DOOR_LOCK_ACCESS_MANAGER_ACCESS_CREDENTIAL_MAX_STORED_KEYS if DOOR_LOCK_ACCESS_MANAGER_IMPLEMENTATION_DEFAULT
    default 255
    range 1 255
    help
      Specifies the maximum number of Kpersistent keys
      that can be supported in the Expedited-fast Phase.

config TRUSTED_STORAGE
    default y

config PSA_PROTECTED_STORAGE
    default y
```

## app/src/aliro/lock_sim/Kconfig
```kconfig
#
# Copyright (c) 2025 Nordic Semiconductor ASA
#
# SPDX-License-Identifier: LicenseRef-Nordic-5-Clause
#

menu "Lock simulator"

config DOOR_LOCK_LOCK_SIM_MOVEMENT_TIME_MS
    int "Movement time of the lock actuator (ms)"
    default 2000
    help
      Specifies the movement time of the lock actuator.
      The movement time is the time it takes for the lock to move from one state to another.

config DOOR_LOCK_LOCK_SIM_AUTO_RELOCK
    bool "Enable auto relock"
    default y
    depends on !CHIP
    help
      Enable auto relock of the lock. When enabled, the lock will relock itself after a certain time.

if DOOR_LOCK_LOCK_SIM_AUTO_RELOCK

config DOOR_LOCK_LOCK_SIM_AUTO_RELOCK_TIME_MS
    int "Auto relock time of the lock (ms)"
    default 5000
    help
      Specifies the auto relock time of the lock.
      The auto relock time is the time it takes for the lock to relock itself after it has been unlocked.

endif # DOOR_LOCK_LOCK_SIM_AUTO_RELOCK

config DOOR_LOCK_LOCK_SIM_INDICATOR
    bool "Enable lock simulator indicator"
    default y
    depends on !CHIP
    help
      Enable the lock simulator indicator. When enabled, the lock simulator will indicate the lock state.

endmenu # Lock simulator
```

## app/src/aliro/platform/Kconfig
```kconfig
#
# Copyright (c) 2025 Nordic Semiconductor ASA
#
# SPDX-License-Identifier: LicenseRef-Nordic-5-Clause
#

rsource "access_decision_indicator/Kconfig"
rsource "crypto/Kconfig"
rsource "nfc/Kconfig"

if DOOR_LOCK_BLE_UWB
rsource "uwb_impl/Kconfig"
endif # DOOR_LOCK_BLE_UWB

if BT
rsource "ble/Kconfig"
endif # BT
```

## app/src/aliro/platform/access_decision_indicator/Kconfig
```kconfig
#
# Copyright (c) 2025 Nordic Semiconductor ASA
#
# SPDX-License-Identifier: LicenseRef-Nordic-5-Clause
#

config ACCESS_DECISION_INDICATOR
	bool "Enable access decision indicator"

config RESET_ACCESS_DECISION_INDICATOR_STATE_DELAY_MS
	int "Access decision indicator reset state delay (ms)"
	depends on ACCESS_DECISION_INDICATOR
	default 1000
	help
		Specifies how long (in milliseconds) the access indicator (e.g. LED) remains active before automatically
		resetting to its default state. This is useful to provide a visual indication of the access decision made
		by a Aliro Access Manager (e.g. LED indication).
```

## app/src/aliro/platform/ble/Kconfig
```kconfig
#
# Copyright (c) 2025 Nordic Semiconductor ASA
#
# SPDX-License-Identifier: LicenseRef-Nordic-5-Clause
#

module = DOOR_LOCK_BLE
module-str = DOOR_LOCK_BLE
module-dep = LOG
module-help = Enables Door Lock BLE platform log messages.
source "$(ZEPHYR_BASE)/subsys/logging/Kconfig.template.log_config"
```

## app/src/aliro/platform/crypto/Kconfig
```kconfig
#
# Copyright (c) 2026 Nordic Semiconductor ASA
#
# SPDX-License-Identifier: LicenseRef-Nordic-5-Clause
#

rsource "Kconfig.defaults"

config DOOR_LOCK_CRYPTO_PSA_AEAD_SINGLE_PART
    bool "Use PSA AEAD single-part API"
    default y if SOC_NRF54LM20A
    help
      When enabled, the single-part AEAD API is used.

if DOOR_LOCK_CRYPTO_PSA_AEAD_SINGLE_PART

config DOOR_LOCK_CRYPTO_PSA_AEAD_SINGLE_PART_BUFFER_SIZE
    int "Maximum size of the buffer used for the single-part AEAD API"
    default 256
    help
      Maximum size of the buffer used for the single-part AEAD API.

endif # DOOR_LOCK_CRYPTO_PSA_AEAD_SINGLE_PART
```

## app/src/aliro/platform/crypto/Kconfig.defaults
```kconfig
#
# Copyright (c) 2026 Nordic Semiconductor ASA
#
# SPDX-License-Identifier: LicenseRef-Nordic-5-Clause
#

config MBEDTLS_PSA_CRYPTO_C
	default y

config MBEDTLS_ENABLE_HEAP
	default y

config MBEDTLS_HEAP_SIZE
	default 8192

config MBEDTLS_X509_LIBRARY
	default y if DOOR_LOCK_CREDENTIAL_ISSUER_CA

config PSA_WANT_ALG_ECDSA
	default y

config PSA_WANT_ALG_ECDH
	default y

config PSA_WANT_KEY_TYPE_ECC_KEY_PAIR_GENERATE
	default y

config PSA_WANT_KEY_TYPE_ECC_KEY_PAIR_IMPORT
	default y

config PSA_WANT_KEY_TYPE_ECC_KEY_PAIR_EXPORT
	default y

config PSA_WANT_ECC_SECP_R1_256
	default y

config PSA_WANT_ALG_SHA_256
	default y

config PSA_WANT_ALG_HKDF
	default y

config PSA_WANT_ALG_HMAC
	default y

config PSA_WANT_KEY_TYPE_HMAC
	default y

config PSA_WANT_KEY_TYPE_AES
	default y

config PSA_WANT_ALG_ECB_NO_PADDING
	default y if NCS_ALIRO_BLE_UWB

config PSA_WANT_GENERATE_RANDOM
	default y

config PSA_WANT_ALG_GCM
	default y

#   Matter + Aliro (NFC+5xBLE/UWB):  (16 + 64 + 5*11) slots -> 136
#   Aliro only (NFC+5xBLE/UWB):      (16+ 5*11) slots ->  72
#   Matter + Aliro (NFC):           (64 + 16) slots ->  80
#   Aliro only (NFC):                9 slots ->  16 (with margin)
config MBEDTLS_PSA_KEY_SLOT_COUNT
	default 136 if CHIP && DOOR_LOCK_BLE_UWB
	default 72 if DOOR_LOCK_BLE_UWB
	default 80 if CHIP
	default 16
```
