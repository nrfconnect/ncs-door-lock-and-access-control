## lib/aliro/Kconfig.ble.defconfig
```kconfig
#
# Copyright (c) 2025 Nordic Semiconductor ASA
#
# SPDX-License-Identifier: LicenseRef-Nordic-5-Clause
#

config BT
	default y

config BT_PERIPHERAL
	default y

config BT_SMP
	default y

config BT_PHY_UPDATE
	default n

config BT_BUF_ACL_RX_SIZE
	default 271

config BT_BUF_ACL_TX_SIZE
	default 271

config BT_L2CAP_TX_MTU
	default 267

config BT_GATT_DYNAMIC_DB
	default y

config BT_GATT_ENFORCE_SUBSCRIPTION
	default y

config BT_GATT_SERVICE_CHANGED
	default y

config BT_L2CAP_DYNAMIC_CHANNEL
	default y

config BT_CTLR_TX_PWR_DYNAMIC_CONTROL
	default y if !SOC_NRF5340_CPUAPP

config BT_BONDABLE
	default n

config BT_ID_MAX
	default 2 if BT_BONDABLE

config BT_MAX_CONN
	default 2 if DOOR_LOCK_BLE_UWB && (DOOR_LOCK_BLE_NUS || DOOR_LOCK_DFU_BLE_SMP)
	default 1
```

## lib/aliro/Kconfig.defconfig
```kconfig
#
# Copyright (c) 2025 Nordic Semiconductor ASA
#
# SPDX-License-Identifier: LicenseRef-Nordic-5-Clause
#

config BT_DEVICE_NAME
	default "AliroDL"

config TRUSTED_STORAGE
	default y

config MBEDTLS_PSA_CRYPTO_STORAGE_C
	default y

choice TRUSTED_STORAGE_BACKEND_AEAD_KEY
	default TRUSTED_STORAGE_BACKEND_AEAD_KEY_HASH_UID if SOC_SERIES_NRF52X
	default TRUSTED_STORAGE_BACKEND_AEAD_KEY_DERIVE_FROM_HUK
endchoice

config HW_UNIQUE_KEY_WRITE_ON_CRYPTO_INIT
	default y if (SOC_NRF5340_CPUAPP || SOC_SERIES_NRF54LX)

# APDU library
config NFC_T4T_APDU
	default y

# required by Aliro persistent storage
config FLASH
	default y

config FLASH_MAP
	default y

config NVS
	default y if !SOC_FLASH_NRF_RRAM

config NVS_LOOKUP_CACHE_SIZE
	default 512 if NVS

config NVS_LOOKUP_CACHE_FOR_SETTINGS
	default y if SETTINGS_NVS

config ZMS
	default y if SOC_FLASH_NRF_RRAM

config ZMS_LOOKUP_CACHE_SIZE
	default 512 if SETTINGS_ZMS

config ZMS_LOOKUP_CACHE_FOR_SETTINGS
	default y if SETTINGS_ZMS

config SETTINGS
	default y

config EVENTS
	default y

config SMF
	default y

config SMF_ANCESTOR_SUPPORT
	default y

config SMF_INITIAL_TRANSITION
	default y

config NRF_SECURITY
	default y

choice NVS_LOG_LEVEL_CHOICE
	default NVS_LOG_LEVEL_ERR
endchoice

choice ZMS_LOG_LEVEL_CHOICE
	default ZMS_LOG_LEVEL_ERR
endchoice

choice SETTINGS_LOG_LEVEL_CHOICE
	default SETTINGS_LOG_LEVEL_ERR
endchoice

choice LIBC_IMPLEMENTATION
    default PICOLIBC
endchoice

choice POSIX_SYSCONF_IMPL_CHOICE
    default POSIX_SYSCONF_IMPL_MACRO if PICOLIBC
endchoice

config SHELL_CMD_BUFF_SIZE
	default 256

config ZCBOR
	default y

config ZCBOR_CANONICAL
	default y

if !CHIP

config MAIN_STACK_SIZE
	default 4096

config HEAP_MEM_POOL_SIZE
	default 4096

config SYSTEM_WORKQUEUE_STACK_SIZE
	default 2048

endif # !CHIP
```

## lib/aliro/interfaces/logger/Kconfig
```kconfig
#
# Copyright (c) 2025 Nordic Semiconductor ASA
#
# SPDX-License-Identifier: LicenseRef-Nordic-5-Clause
#

choice NCS_ALIRO_LOG_LEVEL
    prompt "Log level for Aliro module"
    default NCS_ALIRO_LOG_LEVEL_DBG

config NCS_ALIRO_LOG_LEVEL_OFF
    bool "Aliro module log level set to off"
    help
      No logging

config NCS_ALIRO_LOG_LEVEL_ERR
    bool "Aliro module log level set to error"
    help
      Error logging only

config NCS_ALIRO_LOG_LEVEL_WRN
    bool "Aliro module log level set to warning"
    help
      Warning and error logging

config NCS_ALIRO_LOG_LEVEL_INF
    bool "Aliro module log level set to info"
    help
      Informational, warning and error logging

config NCS_ALIRO_LOG_LEVEL_DBG
    bool "Aliro module log level set to debug"
    help
      Debug, informational, warning and error logging

endchoice

config NCS_ALIRO_LOG_LEVEL_VALUE
    int
    default 0 if NCS_ALIRO_LOG_LEVEL_OFF
    default 1 if NCS_ALIRO_LOG_LEVEL_ERR
    default 2 if NCS_ALIRO_LOG_LEVEL_WRN
    default 3 if NCS_ALIRO_LOG_LEVEL_INF
    default 4 if NCS_ALIRO_LOG_LEVEL_DBG
```

## lib/aliro/interfaces/uwb/Kconfig
```kconfig
#
# Copyright (c) 2025 Nordic Semiconductor ASA
#
# SPDX-License-Identifier: LicenseRef-Nordic-5-Clause
#

config ALIRO_BLE_UWB
	bool "Aliro Bluetooth LE (BLE) transport together with ultra wideband (UWB)"
	default y if DOOR_LOCK_BLE_UWB
	help
	  Enable the Aliro BLE transport protocol (TP). This is the transport layer
	  used by the Reader to communicate with the User Device. It is used to send and
	  receive packets over BLE. Additionally the UWB is enabled in order to manage the
	  ranging between the Reader and the User Device.
```

## lib/qm35_uwb/Kconfig
```kconfig
#
# Copyright (c) 2025 Nordic Semiconductor ASA
#
# SPDX-License-Identifier: LicenseRef-Nordic-5-Clause
#

config QM35_UWB_LIB
	bool "QM35 UWB library"
	depends on SOC_SERIES_NRF53X || SOC_NRF54LM20A
	help
	  Enable support for the Qorvo QM35 UWB chip.
```

## snippets/uwb_qm35_dfu_app/boards/nrf54lm20dk_cpuapp.conf
```kconfig
#
# Copyright (c) 2026 Nordic Semiconductor ASA
#
# SPDX-License-Identifier: LicenseRef-Nordic-5-Clause
#

CONFIG_DFU_MULTI_IMAGE_MAX_IMAGE_COUNT=2
```

## subsys/Kconfig
```kconfig
#
# Copyright (c) 2026 Nordic Semiconductor ASA
#
# SPDX-License-Identifier: LicenseRef-Nordic-5-Clause
#

menu "Door Lock Subsystems"

rsource "advertising_arbiter/Kconfig"
rsource "aliro/Kconfig"
rsource "ble_manager/Kconfig"
rsource "external_nvs/Kconfig"
rsource "matter_access/Kconfig"
rsource "nfc_prop/Kconfig"
rsource "nus_service/Kconfig"
rsource "settings_utils/Kconfig"

endmenu
```

## subsys/advertising_arbiter/Kconfig
```kconfig
#
# Copyright (c) 2026 Nordic Semiconductor ASA
#
# SPDX-License-Identifier: LicenseRef-Nordic-5-Clause
#

menuconfig DOOR_LOCK_ADVERTISING_ARBITER
	bool "BLE advertising arbiter"
	depends on BT
	depends on !CHIP
	help
	  Coordinates BLE advertising between SMP DFU and NUS when multiple components request
	  advertising.

if DOOR_LOCK_ADVERTISING_ARBITER

module = DOOR_LOCK_ADVERTISING_ARBITER
module-str = Door Lock BLE Advertising Arbiter
module-dep = LOG
source "$(ZEPHYR_BASE)/subsys/logging/Kconfig.template.log_config"

config DOOR_LOCK_ADVERTISING_ARBITER_MAX_CONNECTIONS
	int "Maximum number of connections"
	range 1 BT_MAX_CONN
	default 1

endif # DOOR_LOCK_ADVERTISING_ARBITER
```

## subsys/aliro/Kconfig
```kconfig
#
# Copyright (c) 2026 Nordic Semiconductor ASA
#
# SPDX-License-Identifier: LicenseRef-Nordic-5-Clause
#

menu "Aliro Subsystems"

rsource "access_document/Kconfig"
rsource "aliro_service/Kconfig"
rsource "aliro_workqueue/Kconfig"
rsource "crypto_utils/Kconfig"
rsource "door_lock_delegate/Kconfig"
rsource "gatt_server/Kconfig"
rsource "l2cap_server/Kconfig"
rsource "reader_storage/Kconfig"
rsource "time_utils/Kconfig"
rsource "uwb/Kconfig"
rsource "lock_sim/Kconfig"

orsource "disambiguation/Kconfig"

endmenu
```

## subsys/aliro/access_document/Kconfig
```kconfig
#
# Copyright (c) 2026 Nordic Semiconductor ASA
#
# SPDX-License-Identifier: LicenseRef-Nordic-5-Clause
#

config DOOR_LOCK_ALIRO_ACCESS_DOCUMENT_PARSER
	bool "Generate CBOR parser for Aliro Access Document"
	help
	  When enabled, generates code for parsing CBOR-encoded Access Document
	  from the CDDL definition.
```

## subsys/aliro/aliro_service/Kconfig
```kconfig
#
# Copyright (c) 2026 Nordic Semiconductor ASA
#
# SPDX-License-Identifier: LicenseRef-Nordic-5-Clause
#

menuconfig DOOR_LOCK_ALIRO_BLE_SERVICE
	bool "Aliro service"
	depends on BT
	depends on DOOR_LOCK_BLE_UWB
	depends on NCS_ALIRO
	select DOOR_LOCK_ALIRO_GATT_SERVER
	select DOOR_LOCK_ALIRO_L2CAP_SERVER

if DOOR_LOCK_ALIRO_BLE_SERVICE

module = DOOR_LOCK_ALIRO_BLE_SERVICE
module-str = Door Lock Aliro service
source "$(ZEPHYR_BASE)/subsys/logging/Kconfig.template.log_config"

config DOOR_LOCK_ALIRO_BLE_SERVICE_MAX_SESSIONS
	int "Maximum number of Aliro Service sessions"
	range 1 BT_MAX_CONN
	default BT_MAX_CONN
	help
	  Maximum number of concurrent Bluetooth sessions handled by the
	  Aliro service.

config DOOR_LOCK_ALIRO_BLE_SERVICE_BT_ID
	int "Aliro Bluetooth identity"
	default 1
	help
	  Bluetooth identity used by Aliro-specific advertising and connections.
	  This must be a non-default identity and requires BT_ID_MAX to be larger
	  than the configured identity value.

config DOOR_LOCK_ALIRO_BLE_SERVICE_TIMESYNC_PROCEDURE_0
	bool "Timesync Procedure 0 support"
	help
	  Enables advertisement of Aliro BLE and UWB time synchronization
	  Procedure 0 support.

config DOOR_LOCK_ALIRO_BLE_SERVICE_TIMESYNC_PROCEDURE_1
	bool "Timesync Procedure 1 support"
	help
	  Enables advertisement of Aliro BLE and UWB time synchronization
	  Procedure 1 support.

config DOOR_LOCK_ALIRO_BLE_SERVICE_DYNAMIC_TAG
	bool "Dynamic Tag support"
	default y
	depends on DOOR_LOCK_ALIRO_TIME_UTILS
	help
	  Enables periodic regeneration of the Aliro BLE Dynamic Tag with a
	  fresh expiry timestamp sourced from the real-time clock.

if DOOR_LOCK_ALIRO_BLE_SERVICE_DYNAMIC_TAG

config DOOR_LOCK_ALIRO_BLE_SERVICE_DYNAMIC_TAG_EXPIRY_DURATION_S
	int "Dynamic Tag expiry duration in seconds"
	default 900
	range 1 86400
	help
	  How long the Dynamic Tag should remain valid before expiring.

endif # DOOR_LOCK_ALIRO_BLE_SERVICE_DYNAMIC_TAG


endif # DOOR_LOCK_ALIRO_BLE_SERVICE
```

## subsys/aliro/aliro_workqueue/Kconfig
```kconfig
#
# Copyright (c) 2026 Nordic Semiconductor ASA
#
# SPDX-License-Identifier: LicenseRef-Nordic-5-Clause
#

menuconfig DOOR_LOCK_ALIRO_WORKQUEUE
	bool "Aliro workqueue"
	depends on NCS_ALIRO
	help
	  Workqueue dedicated for handling Aliro related work.

if DOOR_LOCK_ALIRO_WORKQUEUE

module = DOOR_LOCK_ALIRO_WORKQUEUE
module-str = Door Lock Aliro workqueue
source "$(ZEPHYR_BASE)/subsys/logging/Kconfig.template.log_config"

config DOOR_LOCK_ALIRO_WORKQUEUE_INIT_PRIORITY
	int "Aliro workqueue init priority"
	default APPLICATION_INIT_PRIORITY

config DOOR_LOCK_ALIRO_WORKQUEUE_STACK_SIZE
	int "Aliro workqueue stack size"
	default 5120

config DOOR_LOCK_ALIRO_WORKQUEUE_PRIORITY
	int "Aliro workqueue priority"
	default 10

endif # DOOR_LOCK_ALIRO_WORKQUEUE
```

## subsys/aliro/crypto_utils/Kconfig
```kconfig
#
# Copyright (c) 2026 Nordic Semiconductor ASA
#
# SPDX-License-Identifier: LicenseRef-Nordic-5-Clause
#

menuconfig DOOR_LOCK_ALIRO_CRYPTO_UTILS
	bool "Aliro Crypto Utils"
	depends on NCS_ALIRO
	select PSA_WANT_KEY_TYPE_ECC_KEY_PAIR_IMPORT
	select PSA_WANT_KEY_TYPE_ECC_KEY_PAIR_EXPORT
	select PSA_WANT_ALG_ECDSA
	select PSA_WANT_ECC_SECP_R1_256
	select PSA_WANT_ALG_SHA_256
	select PSA_WANT_KEY_TYPE_AES

if DOOR_LOCK_ALIRO_CRYPTO_UTILS

module = DOOR_LOCK_ALIRO_CRYPTO_UTILS
module-str = Door Lock Aliro Crypto Utils
source "$(ZEPHYR_BASE)/subsys/logging/Kconfig.template.log_config"

endif # DOOR_LOCK_ALIRO_CRYPTO_UTILS
```

## subsys/aliro/disambiguation/Kconfig
```kconfig
#
# Copyright (c) 2026 Nordic Semiconductor ASA
#
# SPDX-License-Identifier: LicenseRef-Nordic-5-Clause
#

menuconfig DOOR_LOCK_ALIRO_UWB_DISAMBIGUATION
	bool "UWB front/back disambiguation [EXPERIMENTAL]"
	depends on DOOR_LOCK_ALIRO_UWB
	depends on QM35_UWB_ALIRO_ZEPHYR
	select Q_ALIRO_DISAMBIGUATION
	select EXPERIMENTAL
	help
	  Enable the front/back disambiguation algorithm (CIR, distance, and PDOA processing).

if DOOR_LOCK_ALIRO_UWB_DISAMBIGUATION

config DOOR_LOCK_ALIRO_UWB_DISAMBIGUATION_MAX_CIR
	int "Max CIR threshold for disambiguation"
	default 800
	range 100 5000
	help
	  Maximum absolute CIR value. When the radar CIR exceeds this threshold,
	  the algorithm reuses the previous FRONT/BACK decision instead of
	  computing p_ratio. Increase if genuine detections are being skipped.

config DOOR_LOCK_ALIRO_UWB_DISAMBIGUATION_P_RATIO
	int "p_ratio threshold for disambiguation"
	default 7500 if DOOR_LOCK_ALIRO_UWB_QM35_ANTENNA_4PORT
	default 6000 if DOOR_LOCK_ALIRO_UWB_QM35_ANTENNA_2PORT
	default 7500
	range 1 30000
	help
	  Minimum p_ratio for FRONT detection. The value is multiplied by 10000
	  (e.g. set 6000 for 0.6). p_ratio is derived from radar CIR amplitude
	  and phone RSSI. Lower values increase FRONT detection range but reduce
	  accuracy.

config DOOR_LOCK_ALIRO_UWB_DISAMBIGUATION_NB_BLOCKS
	int "Max noise blocks threshold for disambiguation"
	default 10
	range 0 40
	help
	  Maximum number of noise blocks allowed for a FRONT decision.
	  Higher values are more permissive (easier FRONT detection).

config DOOR_LOCK_ALIRO_UWB_DISAMBIGUATION_NOISE_THRESHOLD
	int "Noise block amplitude threshold"
	default 15
	range 1 100
	help
	  CIR amplitude below which a block is classified as noise (normal angle).

config DOOR_LOCK_ALIRO_UWB_DISAMBIGUATION_SHADOW_THRESHOLD
	int "Shadow noise block amplitude threshold"
	default 8
	range 1 100
	help
	  CIR amplitude below which a block is classified as noise in the shadow region (back side).

config DOOR_LOCK_ALIRO_UWB_DISAMBIGUATION_BLIND_DISTANCE_CM
	int "Blind distance (cm) below which disambiguation is disabled"
	default 30
	range 0 100
	help
	  Minimum distance for the algorithm to engage. Below this value the
	  result is unreliable (too close to the antenna).

config DOOR_LOCK_ALIRO_UWB_DISAMBIGUATION_SECURE_BUBBLE_CM
	int "Secure bubble radius (cm) for door open confirmation"
	default 150
	range 10 200
	help
	  Door open is confirmed only when the user is within this distance.
	  Acts as a final gate after FRONT is detected.

config DOOR_LOCK_ALIRO_UWB_DISAMBIGUATION_FRONT_TO_BACK_CONFIRM
	int "Consecutive BACK ticks required for FRONT to BACK transition"
	default 8
	range 1 20
	help
	  Number of consecutive BACK results required to switch the side
	  decision from FRONT to BACK. Acts as a low-pass filter to prevent
	  spurious BACK flashes (e.g. caused by CIR saturation or transient
	  noise). Higher values make the FRONT state more stable.

config DOOR_LOCK_ALIRO_UWB_DISAMBIGUATION_BACK_TO_FRONT_CONFIRM
	int "Consecutive FRONT ticks required for BACK to FRONT transition"
	default 6
	range 1 20
	help
	  Number of consecutive FRONT results required to switch the side
	  decision from BACK to FRONT. Acts as a low-pass filter to prevent
	  spurious FRONT detections. Lower values make FRONT detection faster.

config DOOR_LOCK_ALIRO_UWB_DISAMBIGUATION_PDOA_OFFSET_DEG
	int "PDOA calibration offset (degrees)"
	default 0
	range -180 180
	help
	  PDOA offset in degrees subtracted from raw PDOA before feeding the
	  disambiguation algorithm. Compensates for antenna placement.

config DOOR_LOCK_ALIRO_UWB_DISAMBIGUATION_DISTANCE_OFFSET_CM
	int "Distance calibration offset (cm)"
	default 0
	range -200 200
	help
	  Distance offset in cm subtracted from raw UWB range measurements
	  before feeding the disambiguation algorithm. Compensates for
	  systematic ranging bias.

module = DOOR_LOCK_ALIRO_UWB_DISAMBIGUATION
module-str = "UWB disambiguation"
module-dep = LOG
source "$(ZEPHYR_BASE)/subsys/logging/Kconfig.template.log_config"

endif # DOOR_LOCK_ALIRO_UWB_DISAMBIGUATION
```

## subsys/aliro/door_lock_delegate/Kconfig
```kconfig
#
# Copyright (c) 2026 Nordic Semiconductor ASA
#
# SPDX-License-Identifier: LicenseRef-Nordic-5-Clause
#

menuconfig DOOR_LOCK_ALIRO_DOOR_LOCK_DELEGATE
	bool "Matter Door Lock Delegate for Aliro"
	depends on CHIP
	depends on NCS_ALIRO
	depends on DOOR_LOCK_ALIRO_READER_STORAGE
	depends on PSA_WANT_GENERATE_RANDOM

if DOOR_LOCK_ALIRO_DOOR_LOCK_DELEGATE

module = DOOR_LOCK_ALIRO_DOOR_LOCK_DELEGATE
module-str = Door Lock Aliro Door Lock Delegate
source "$(ZEPHYR_BASE)/subsys/logging/Kconfig.template.log_config"

config DOOR_LOCK_ALIRO_DOOR_LOCK_DELEGATE_BLE_UWB_SUPPORT
	bool "BLE/UWB Support in Door Lock Delegate"
	depends on NCS_ALIRO_BLE_UWB
	depends on DOOR_LOCK_ALIRO_READER_STORAGE_GROUP_RESOLVING_KEY_SUPPORT
	default y

endif # DOOR_LOCK_ALIRO_DOOR_LOCK_DELEGATE
```

## subsys/aliro/gatt_server/Kconfig
```kconfig
#
# Copyright (c) 2026 Nordic Semiconductor ASA
#
# SPDX-License-Identifier: LicenseRef-Nordic-5-Clause
#

menuconfig DOOR_LOCK_ALIRO_GATT_SERVER
	bool "Aliro gatt server"
	depends on BT
	depends on NCS_ALIRO

if DOOR_LOCK_ALIRO_GATT_SERVER

module = DOOR_LOCK_ALIRO_GATT_SERVER
module-str = Door Lock Aliro gatt server
source "$(ZEPHYR_BASE)/subsys/logging/Kconfig.template.log_config"

endif # DOOR_LOCK_ALIRO_GATT_SERVER
```
