## subsys/aliro/l2cap_server/Kconfig
```kconfig
#
# Copyright (c) 2026 Nordic Semiconductor ASA
#
# SPDX-License-Identifier: LicenseRef-Nordic-5-Clause
#

menuconfig DOOR_LOCK_ALIRO_L2CAP_SERVER
	bool "Aliro l2cap server"
	depends on BT

if DOOR_LOCK_ALIRO_L2CAP_SERVER

config DOOR_LOCK_ALIRO_L2CAP_SERVER_MAX_SESSIONS
	int "Maximum number of L2CAP server sessions"
	range 1 BT_MAX_CONN
	default BT_MAX_CONN
	help
	  Maximum number of concurrent sessions handled by the Aliro L2CAP server.

module = DOOR_LOCK_ALIRO_L2CAP_SERVER
module-str = Door Lock Aliro l2cap server
source "$(ZEPHYR_BASE)/subsys/logging/Kconfig.template.log_config"

endif # DOOR_LOCK_ALIRO_L2CAP_SERVER
```

## subsys/aliro/reader_storage/Kconfig
```kconfig
#
# Copyright (c) 2026 Nordic Semiconductor ASA
#
# SPDX-License-Identifier: LicenseRef-Nordic-5-Clause
#

menuconfig DOOR_LOCK_ALIRO_READER_STORAGE
	bool "Reader Storage"
	depends on PSA_PROTECTED_STORAGE
	select DOOR_LOCK_ALIRO_CRYPTO_UTILS

if DOOR_LOCK_ALIRO_READER_STORAGE

module = DOOR_LOCK_ALIRO_READER_STORAGE
module-str = Door Lock Reader Storage
source "$(ZEPHYR_BASE)/subsys/logging/Kconfig.template.log_config"

config DOOR_LOCK_ALIRO_READER_STORAGE_GROUP_RESOLVING_KEY_SUPPORT
	bool "Group Resolving Key Support"

config DOOR_LOCK_ALIRO_READER_STORAGE_IDENTIFIER_PSA_STORAGE_UID
	hex "Reader Identifier PSA Storage UID"
	default 0x500000000

config DOOR_LOCK_ALIRO_READER_STORAGE_PRIVATE_KEY_PSA_KEY_ID
	hex "Reader Private Key PSA Key ID"
	default 0x40000

if DOOR_LOCK_ALIRO_READER_STORAGE_GROUP_RESOLVING_KEY_SUPPORT

config DOOR_LOCK_ALIRO_READER_STORAGE_GROUP_RESOLVING_KEY_PSA_KEY_ID
	hex "Group Resolving Key PSA Key ID"
	default 0x40001

endif # DOOR_LOCK_ALIRO_READER_STORAGE_GROUP_RESOLVING_KEY_SUPPORT

config DOOR_LOCK_ALIRO_READER_STORAGE_CERTIFICATE_SUPPORT
	bool "Certificate Support"
	depends on SETTINGS
	select DOOR_LOCK_SETTINGS_UTILS

if DOOR_LOCK_ALIRO_READER_STORAGE_CERTIFICATE_SUPPORT

config DOOR_LOCK_ALIRO_READER_STORAGE_SETTINGS_BASE_KEY_NAME
	string "Settings base key name"
	default "reader"

config DOOR_LOCK_ALIRO_READER_STORAGE_CERTIFICATE_MAX_SIZE
	int "Maximum size of the Reader certificate"
	default 512

endif # DOOR_LOCK_ALIRO_READER_STORAGE_CERTIFICATE_SUPPORT

rsource "src/shell/Kconfig"

endif # DOOR_LOCK_ALIRO_READER_STORAGE
```

## subsys/aliro/reader_storage/src/shell/Kconfig
```kconfig
#
# Copyright (c) 2026 Nordic Semiconductor ASA
#
# SPDX-License-Identifier: LicenseRef-Nordic-5-Clause
#

config DOOR_LOCK_ALIRO_READER_STORAGE_SHELL
	bool "Shell commands for Reader Storage"
	depends on SHELL
	help
	  Enable shell commands for the Reader Storage.

if DOOR_LOCK_ALIRO_READER_STORAGE_SHELL

config DOOR_LOCK_ALIRO_READER_STORAGE_SHELL_CORE
	bool "Core commands"
	help
	  Enable core commands for the Reader Storage.

config DOOR_LOCK_ALIRO_READER_STORAGE_SHELL_CERT
	bool "Certificate commands"
	depends on DOOR_LOCK_ALIRO_READER_STORAGE_CERTIFICATE_SUPPORT
	help
	  Enable Reader Certificate commands for the Reader Storage.

config DOOR_LOCK_ALIRO_READER_STORAGE_SHELL_GROUP
	bool "Group Resolving Key commands"
	depends on DOOR_LOCK_ALIRO_READER_STORAGE_GROUP_RESOLVING_KEY_SUPPORT
	help
	  Enable Group Resolving Key commands for the Reader Storage.

endif # DOOR_LOCK_ALIRO_READER_STORAGE_SHELL
```

## subsys/aliro/time_utils/Kconfig
```kconfig
#
# Copyright (c) 2026 Nordic Semiconductor ASA
#
# SPDX-License-Identifier: LicenseRef-Nordic-5-Clause
#

menuconfig DOOR_LOCK_ALIRO_TIME_UTILS
	bool "Aliro Time Utils"
	depends on NCS_ALIRO && CHIP

if DOOR_LOCK_ALIRO_TIME_UTILS

module = DOOR_LOCK_ALIRO_TIME_UTILS
module-str = Door Lock Aliro Time Utils
source "$(ZEPHYR_BASE)/subsys/logging/Kconfig.template.log_config"

endif # DOOR_LOCK_ALIRO_TIME_UTILS
```

## subsys/aliro/uwb/qm35_impl/Kconfig
```kconfig
#
# Copyright (c) 2025 Nordic Semiconductor ASA
#
# SPDX-License-Identifier: LicenseRef-Nordic-5-Clause
#

config DOOR_LOCK_ALIRO_UWB_QM35_EXPERIMENTAL
	bool
	select EXPERIMENTAL
	default y

config DOOR_LOCK_ALIRO_UWB_MIN_RAN_MULTIPLIER
	int "Minimum RAN multiplier for UWB ranging blocks"
	default 8 if DOOR_LOCK_BLE_UWB_MAX_SESSIONS >= 5
	default 7 if DOOR_LOCK_BLE_UWB_MAX_SESSIONS >= 4
	default 6 if DOOR_LOCK_BLE_UWB_MAX_SESSIONS >= 3
	default 4 if DOOR_LOCK_BLE_UWB_MAX_SESSIONS >= 2
	default 2
	range 1 255
	help
	  The RAN multiplier allows to define the time between 2 ranging blocks.
	  The time range is between 96 ms (RAN multiplier is 1) and 24480 ms
	  (RAN multiplier is 255).

config DOOR_LOCK_ALIRO_UWB_MAC_MODE_OFFSET
	int "Offset between ranging blocks in MAC mode"
	default 0
	range 0 63
	help
	  Offset between the 2 ranging blocks.

config DOOR_LOCK_ALIRO_UWB_MAC_MODE_RANGING_ROUNDS
	int "Number of ranging rounds per ranging block"
	default 0
	range 0 1
	help
	  Number of ranging rounds used in a ranging block.
	  Values:
	  - 0: 1 ranging round
	  - 1: 2 ranging round

config DOOR_LOCK_ALIRO_UWB_SESSION_LOGGING
	bool "Enable UWB session state logging"
	help
	  Enable logging for UWB session states and reason codes.

config DOOR_LOCK_ALIRO_UWB_RANGING_SESSION_LOG
	bool "Enable session context in UWB ranging logs"
	help
	  Prefix each ranging log with the session identifier and the
	  current number of active ranging sessions.

config DOOR_LOCK_ALIRO_UWB_QM35_DFU
	bool "Enable firmware upgrade for QM35"
	help
	  Enable update procedure for QM35 during initialization

if DOOR_LOCK_ALIRO_UWB_QM35_DFU

choice DOOR_LOCK_ALIRO_UWB_QM35_DFU_VERSION_COMPARISON
	prompt "Method used for QM35 version comparison"
	default DOOR_LOCK_ALIRO_UWB_QM35_DFU_VERSION_COMPARISON_HIGHER

config DOOR_LOCK_ALIRO_UWB_QM35_DFU_VERSION_COMPARISON_HIGHER
	bool "Perform DFU only if the version is higher (avoid rollbacks)"

config DOOR_LOCK_ALIRO_UWB_QM35_DFU_VERSION_COMPARISON_DIFFERENT
	bool "Perform DFU for any different version"

endchoice # DOOR_LOCK_ALIRO_UWB_QM35_DFU_VERSION_COMPARISON

endif # DOOR_LOCK_ALIRO_UWB_QM35_DFU

rsource "radar/Kconfig"
rsource "diagnostics/Kconfig"
rsource "front_back_detection/Kconfig"

choice DOOR_LOCK_ALIRO_UWB_QM35_ANTENNA_CONFIG
	prompt "Antenna configuration"
	default DOOR_LOCK_ALIRO_UWB_QM35_ANTENNA_4PORT
	help
	  Select the QM35 antenna configuration.

config DOOR_LOCK_ALIRO_UWB_QM35_ANTENNA_2PORT
	bool "2-port antenna"

config DOOR_LOCK_ALIRO_UWB_QM35_ANTENNA_4PORT
	bool "4-port antenna"

endchoice # DOOR_LOCK_ALIRO_UWB_QM35_ANTENNA_CONFIG
```

## subsys/aliro/uwb/qm35_impl/diagnostics/Kconfig
```kconfig
#
# Copyright (c) 2026 Nordic Semiconductor ASA
#
# SPDX-License-Identifier: LicenseRef-Nordic-5-Clause
#

config DOOR_LOCK_ALIRO_UWB_QM35_DIAGNOSTICS
	bool "Enable UWB diagnostics support"
	help
	  Enable UWB diagnostics support.

if DOOR_LOCK_ALIRO_UWB_QM35_DIAGNOSTICS

config DOOR_LOCK_ALIRO_UWB_QM35_DIAGNOSTICS_DEFAULT_HANDLER
	bool "Enable default diagnostic report handler"
	default y
	help
	  Enable default diagnostic report handler
	  that transforms the AoA raw data into degrees and logs it.

module = DOOR_LOCK_ALIRO_UWB_QM35_DIAGNOSTICS
module-str = Door Lock Aliro UWB QM35 Diagnostics
module-dep = LOG
source "$(ZEPHYR_BASE)/subsys/logging/Kconfig.template.log_config"

endif # DOOR_LOCK_ALIRO_UWB_QM35_DIAGNOSTICS
```

## subsys/aliro/uwb/qm35_impl/front_back_detection/Kconfig
```kconfig
#
# Copyright (c) 2026 Nordic Semiconductor ASA
#
# SPDX-License-Identifier: LicenseRef-Nordic-5-Clause
#

config DOOR_LOCK_ALIRO_UWB_QM35_FRONT_BACK_DETECTION
	bool "Enable QM35 UWB front/back detection integration"
	select DOOR_LOCK_ALIRO_UWB_QM35_DIAGNOSTICS
	select DOOR_LOCK_ALIRO_UWB_DISAMBIGUATION
	select DOOR_LOCK_ALIRO_UWB_QM35_RADAR
	help
	  Enable front/back detection integration for the QM35 UWB implementation,
	  including session-event hooks and periodic front/back detection processing.

if DOOR_LOCK_ALIRO_UWB_QM35_FRONT_BACK_DETECTION

config DOOR_LOCK_ALIRO_UWB_QM35_FRONT_BACK_DETECTION_PROCESSING_INTERVAL_MS
	int "Front/back detection processing interval (ms)"
	default 48
	range 1 1000
	help
	  Period between front/back detection Process() runs while ranging is active.

module = DOOR_LOCK_ALIRO_UWB_QM35_FRONT_BACK_DETECTION
module-str = Door Lock Aliro UWB QM35 Front Back Detection
module-dep = LOG
source "$(ZEPHYR_BASE)/subsys/logging/Kconfig.template.log_config"

endif # DOOR_LOCK_ALIRO_UWB_QM35_FRONT_BACK_DETECTION
```

## subsys/aliro/uwb/qm35_impl/radar/Kconfig
```kconfig
#
# Copyright (c) 2026 Nordic Semiconductor ASA
#
# SPDX-License-Identifier: LicenseRef-Nordic-5-Clause
#

config DOOR_LOCK_ALIRO_UWB_QM35_RADAR
	bool "Enable UWB radar support"
	help
	  Enable UWB radar support.

if DOOR_LOCK_ALIRO_UWB_QM35_RADAR

config DOOR_LOCK_ALIRO_UWB_QM35_RADAR_ANT_SET_ID
	int "Radar antenna set ID"
	range 2 3
	default 3
	help
	  Antenna set used by the Cherry radar session.

config DOOR_LOCK_ALIRO_UWB_QM35_RADAR_CHANNEL
	int "Radar channel"
	range 5 9
	default 9
	help
	  UWB channel used by the Cherry radar session. Typically use channel 5 or 9.

config DOOR_LOCK_ALIRO_UWB_QM35_RADAR_ACTIVATION_DISTANCE_CM
	int "UWB distance threshold for radar session activation (cm)"
	default 150
	range 30 500
	help
	  The radar session is started only when the UWB ranging distance drops
	  below this value.

module = DOOR_LOCK_ALIRO_UWB_QM35_RADAR
module-str = Door Lock Aliro UWB QM35 Radar
module-dep = LOG
source "$(ZEPHYR_BASE)/subsys/logging/Kconfig.template.log_config"

endif # DOOR_LOCK_ALIRO_UWB_QM35_RADAR
```
