## CMakeLists.txt
```
#
# Copyright (c) 2026 Nordic Semiconductor ASA
#
# SPDX-License-Identifier: LicenseRef-Nordic-5-Clause
#

cmake_minimum_required(VERSION 3.20.0)

find_package(Zephyr REQUIRED HINTS $ENV{ZEPHYR_BASE})
project(coap_service_sample)

target_sources(app PRIVATE src/main.cpp)
```

## sample.yaml
```
sample:
  name: CoAP door lock service
  description: Minimal Wi-Fi demo of the coap_service snippet
common:
  build_only: true
  platform_allow:
    - nrf7120dk/nrf7120/cpuapp
  integration_platforms:
    - nrf7120dk/nrf7120/cpuapp
  extra_args:
    - SNIPPET=coap_service
tests:
  sample.coap_service: {}
  sample.coap_service.configured:
    extra_configs:
      - CONFIG_DOOR_LOCK_COAP_SERVICE_PORT=65535
      - CONFIG_DOOR_LOCK_COAP_RESOURCE_PATH="front-door"
```

## prj.conf
```kconfig
#
# Copyright (c) 2026 Nordic Semiconductor ASA
#
# SPDX-License-Identifier: LicenseRef-Nordic-5-Clause
#

CONFIG_CPP=y
CONFIG_DK_LIBRARY=y

# IPv4 Wi-Fi with DHCP; connect manually using the shell.
CONFIG_WIFI=y
CONFIG_WIFI_NM_WPA_SUPPLICANT=y
CONFIG_WIFI_NRF71_PATCH=y
CONFIG_NET_IPV4=y
CONFIG_NET_IPV6=n
CONFIG_NET_UDP=y
CONFIG_NET_DHCPV4=y

CONFIG_NET_SHELL=y
CONFIG_NET_L2_WIFI_SHELL=y
CONFIG_SHELL_STACK_SIZE=5400
CONFIG_ZVFS_POLL_MAX=10

CONFIG_LOG=y
CONFIG_PRINTK=y
```

## src/main.cpp
```c
/*
 * Copyright (c) 2026 Nordic Semiconductor ASA
 *
 * SPDX-License-Identifier: LicenseRef-Nordic-5-Clause
 */

#include "aliro/types.h"
#include <atomic>
#include <coap_service/coap_service.h>
#include <dk_buttons_and_leds.h>
#include <zephyr/kernel.h>
#include <zephyr/sys/printk.h>

static std::atomic<Aliro::ReaderStateByte> sState{ Aliro::ReaderStateByte::Unknown };

static Aliro::ReaderStateByte GetState()
{
	return sState;
}

static void Unlock()
{
	sState = Aliro::ReaderStateByte::Unsecured;
	DoorLock::CoAPService::Notify(sState);
	printk("Door unlocked\n");
	dk_set_led(DK_LED1, false);
}

static void Lock()
{
	sState = Aliro::ReaderStateByte::Secured;
	DoorLock::CoAPService::Notify(sState);
	printk("Door locked\n");
	dk_set_led(DK_LED1, true);
}

static void ButtonChanged(uint32_t buttonState, uint32_t changedButtons)
{
	if (buttonState & changedButtons & DK_BTN1_MSK) {
		if (sState == Aliro::ReaderStateByte::Secured) {
			Unlock();
		} else {
			Lock();
		}
	}
}

int main()
{
	DoorLock::CoAPService::Init(GetState, Unlock, Lock);

	int err = dk_buttons_init(ButtonChanged);
	if (err) {
		printk("Button initialization failed: %d\n", err);
		return err;
	}

	err = dk_leds_init();
	if (err) {
		printk("LED initialization failed: %d\n", err);
		return err;
	}

	err = DoorLock::CoAPService::Start();
	if (err) {
		printk("CoAP service start failed: %d\n", err);
		return err;
	}

	Lock();

	printk("Button 0 toggles the lock.\n"
	       "Connect with: wifi connect -s \"SSID\" -k 1 -p \"PASSWORD\"\n"
	       "Use net ipv4 to find the address; CoAP: /%s, UDP %u.\n",
	       CONFIG_DOOR_LOCK_COAP_RESOURCE_PATH, CONFIG_DOOR_LOCK_COAP_SERVICE_PORT);
	return 0;
}
```
