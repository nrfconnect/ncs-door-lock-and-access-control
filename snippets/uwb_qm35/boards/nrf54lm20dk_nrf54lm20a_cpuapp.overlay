/*
 * Copyright (c) 2025 Nordic Semiconductor ASA
 *
 * SPDX-License-Identifier: LicenseRef-Nordic-5-Clause
 */

&spi21 {
	/* CS array: @0: NFC reader             @1: QM35 UWB module */
	cs-gpios = <&gpio1 24 GPIO_ACTIVE_LOW>, <&gpio3 11 GPIO_ACTIVE_LOW>;

	qm35: hsspi@1 {
		status = "okay";
		compatible = "qorvo,hsspi";
		reg = <1>;
		spi-max-frequency = <DT_FREQ_M(4)>;
		ss-irq-gpios = <&gpio0 0 (GPIO_ACTIVE_HIGH | GPIO_PULL_DOWN)>;
		reset-gpios = <&gpio3 7 (GPIO_ACTIVE_LOW | GPIO_OPEN_DRAIN)>;
		exton-gpios = <&gpio3 12 GPIO_ACTIVE_HIGH>;
	};
};

&gpio3 {
	status = "okay";
};
